## CMakeLists.txt
```
cmake_minimum_required(VERSION 3.20.0)

get_filename_component(KFSW_WORKSPACE_ROOT
    "${CMAKE_CURRENT_LIST_DIR}/../../../.."
    ABSOLUTE
)

list(APPEND ZEPHYR_EXTRA_MODULES
    "${KFSW_WORKSPACE_ROOT}/kfsw-platform"
)

find_package(Zephyr REQUIRED HINTS $ENV{ZEPHYR_BASE})
project(kfsw_platform_storage_tests LANGUAGES C)

target_sources(app PRIVATE src/main.c)
target_link_libraries(app PRIVATE kfsw::platform)
```

## prj.conf
```kconfig
CONFIG_ZTEST=y

CONFIG_FLASH=y
CONFIG_FLASH_MAP=y
CONFIG_FILE_SYSTEM=y
CONFIG_FILE_SYSTEM_LITTLEFS=y
CONFIG_FILE_SYSTEM_MKFS=y
CONFIG_KFSW_STORAGE=y

CONFIG_DISK_ACCESS=y
CONFIG_FS_LITTLEFS_BLK_DEV=y
```

## boards/native_sim_native_64.overlay
```dts
/ {
	chosen {
		kfsw,storage-partition = &storage_partition;
		kfsw,tmp-disk = &tmp_disk;
	};

	/* RAM volume behind /kfsw/tmp. */
	tmp_disk: tmp-disk {
		compatible = "zephyr,ram-disk";
		disk-name = "TMP";
		sector-size = <512>;
		sector-count = <64>;
	};
};

&storage_partition {
	label = "kfsw-storage-test";
	reg = <0x000fc000 0x00010000>;
};
```

## src/main.c
```c
#include <errno.h>
#include <stdint.h>
#include <string.h>

#include <zephyr/devicetree.h>
#include <zephyr/fs/fs.h>
#include <zephyr/fs/littlefs.h>
#include <zephyr/storage/flash_map.h>
#include <zephyr/ztest.h>

#include <kfsw/platform/storage.h>

#define STORAGE_PARTITION_NODE DT_CHOSEN(kfsw_storage_partition)
#define STORAGE_PARTITION_ID DT_FIXED_PARTITION_ID(STORAGE_PARTITION_NODE)
#define STORAGE_TEST_PATH KFSW_STORAGE_MOUNT_POINT "/unit-test"

static void erase_storage_partition(void)
{
	const struct flash_area *area;
	int result;

	result = flash_area_open(STORAGE_PARTITION_ID, &area);
	zassert_ok(result, "failed to open storage partition");
	result = flash_area_flatten(area, 0, area->fa_size);
	flash_area_close(area);
	zassert_ok(result, "failed to erase storage partition");
}

static void *storage_setup(void)
{
	erase_storage_partition();
	zassert_ok(kfsw_storage_init(), "storage init failed");
	zassert_ok(kfsw_storage_mount(), "first-boot storage mount failed");
	return NULL;
}

ZTEST(platform_storage, test_basic_file_operation)
{
	static const char expected[] = "K-FSW storage unit test";
	struct fs_file_t file;
	char actual[sizeof(expected)] = {0};
	ssize_t result;

	fs_file_t_init(&file);
	zassert_ok(fs_open(&file, STORAGE_TEST_PATH, FS_O_CREATE | FS_O_WRITE | FS_O_TRUNC),
		   "file create failed");
	result = fs_write(&file, expected, sizeof(expected));
	zassert_equal(result, sizeof(expected), "file write failed");
	zassert_ok(fs_close(&file), "file close after write failed");

	fs_file_t_init(&file);
	zassert_ok(fs_open(&file, STORAGE_TEST_PATH, FS_O_READ), "file reopen failed");
	result = fs_read(&file, actual, sizeof(actual));
	zassert_equal(result, sizeof(actual), "file read failed");
	zassert_mem_equal(actual, expected, sizeof(expected), "file content mismatch");
	zassert_ok(fs_close(&file), "file close after read failed");
	zassert_ok(fs_unlink(STORAGE_TEST_PATH), "file delete failed");
}

ZTEST(platform_storage, test_corrupt_non_erased_media_is_not_formatted)
{
	const struct flash_area *area;
	uint8_t corrupt_byte = 0U;
	uint8_t actual_byte = UINT8_MAX;
	int result;

	zassert_ok(kfsw_storage_unmount(), "storage unmount failed");
	erase_storage_partition();

	zassert_ok(flash_area_open(STORAGE_PARTITION_ID, &area), "partition open failed");
	zassert_ok(flash_area_write(area, 0, &corrupt_byte, sizeof(corrupt_byte)),
		   "corrupt marker write failed");
	flash_area_close(area);

	result = kfsw_storage_mount();
	zassert_equal(result, -EFAULT, "corrupt media was not rejected");
	zassert_false(kfsw_storage_is_ready(), "corrupt media reported ready");

	zassert_ok(flash_area_open(STORAGE_PARTITION_ID, &area), "partition reopen failed");
	zassert_ok(flash_area_read(area, 0, &actual_byte, sizeof(actual_byte)),
		   "corrupt marker read failed");
	flash_area_close(area);
	zassert_equal(actual_byte, corrupt_byte, "corrupt media was automatically formatted");

	erase_storage_partition();
	zassert_ok(kfsw_storage_mount(), "storage recovery mount failed");
}

ZTEST(platform_storage, test_info_and_invalid_argument)
{
	struct kfsw_storage_info info;

	zassert_equal(kfsw_storage_get_info(NULL), -EINVAL, "NULL info was accepted");
	zassert_ok(kfsw_storage_get_info(&info), "storage info failed");
	zassert_true(info.ready, "storage info did not report ready");
	zassert_equal(strcmp(info.filesystem, "LittleFS"), 0, "wrong filesystem");
	zassert_equal(strcmp(info.mount_point, KFSW_STORAGE_MOUNT_POINT), 0, "wrong mount point");
	zassert_not_null(info.backend, "missing backend name");
	zassert_true(info.total_bytes > 0U, "total capacity was not reported");
	zassert_true(info.free_bytes > 0U, "free capacity was not reported");
	zassert_true(info.free_bytes <= info.total_bytes, "free capacity exceeds total");
}

ZTEST(platform_storage, test_lifecycle_is_idempotent)
{
	zassert_ok(kfsw_storage_init(), "repeated init failed");
	zassert_ok(kfsw_storage_mount(), "repeated mount failed");
	zassert_true(kfsw_storage_is_ready(), "storage is not ready");
}

ZTEST(platform_storage, test_unmounted_state_is_reported)
{
	struct kfsw_storage_info info;

	zassert_ok(kfsw_storage_unmount(), "storage unmount failed");
	zassert_ok(kfsw_storage_unmount(), "repeated unmount failed");
	zassert_false(kfsw_storage_is_ready(), "unmounted storage reported ready");
	zassert_ok(kfsw_storage_get_info(&info), "unmounted storage info failed");
	zassert_false(info.ready, "unmounted info reported ready");
	zassert_equal(info.total_bytes, 0U, "unmounted total capacity is nonzero");
	zassert_equal(info.free_bytes, 0U, "unmounted free capacity is nonzero");
	zassert_ok(kfsw_storage_mount(), "remount failed");
}

FS_LITTLEFS_DECLARE_CUSTOM_CONFIG(stale_littlefs, 4, 512, 512, 512, 8);

/* A file left on the RAM disk before the mount, as SRAM2 keeps one across a reset. */
static void leave_stale_file(void)
{
	struct fs_mount_t stale = {
		.type = FS_LITTLEFS,
		.fs_data = &stale_littlefs,
		.storage_dev = (void *)"TMP",
		.mnt_point = "/stale",
		.flags = FS_MOUNT_FLAG_USE_DISK_ACCESS,
	};
	struct fs_file_t file;

	zassert_ok(fs_mount(&stale));
	fs_file_t_init(&file);
	zassert_ok(fs_open(&file, "/stale/left.bin", FS_O_CREATE | FS_O_WRITE));
	zassert_equal(fs_write(&file, "x", 1U), 1);
	zassert_ok(fs_close(&file));
	zassert_ok(fs_unmount(&stale));
}

ZTEST(platform_storage, test_tmp_starts_empty)
{
	struct kfsw_storage_info info;
	struct fs_dirent entry;

	leave_stale_file();
	zassert_ok(kfsw_storage_tmp_mount());
	zassert_equal(fs_stat(KFSW_STORAGE_TMP_MOUNT_POINT "/left.bin", &entry), -ENOENT);

	zassert_ok(fs_mkdir(KFSW_STORAGE_TMP_MOUNT_POINT "/kept"));
	zassert_ok(kfsw_storage_tmp_mount(), "a second call while mounted is harmless");
	zassert_ok(fs_stat(KFSW_STORAGE_TMP_MOUNT_POINT "/kept", &entry));

	zassert_ok(kfsw_storage_get_tmp_info(&info));
	zassert_true(info.ready);
	zassert_str_equal(info.mount_point, KFSW_STORAGE_TMP_MOUNT_POINT);
	zassert_equal(info.total_bytes, 32U * 1024U);
	zassert_true((info.free_bytes > 0U) && (info.free_bytes < info.total_bytes));
}

ZTEST_SUITE(platform_storage, NULL, storage_setup, NULL, NULL, NULL);
```
