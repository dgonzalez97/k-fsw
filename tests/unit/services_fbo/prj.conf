## CMakeLists.txt
```
cmake_minimum_required(VERSION 3.20.0)

get_filename_component(KFSW_WORKSPACE_ROOT
    "${CMAKE_CURRENT_LIST_DIR}/../../../.."
    ABSOLUTE
)

list(APPEND ZEPHYR_EXTRA_MODULES
    "${KFSW_WORKSPACE_ROOT}/kfsw-platform"
    "${KFSW_WORKSPACE_ROOT}/kfsw-services"
)

find_package(Zephyr REQUIRED HINTS $ENV{ZEPHYR_BASE})
project(kfsw_services_fbo_tests LANGUAGES C)

target_sources(app PRIVATE src/main.c)
target_link_libraries(app PRIVATE kfsw::services)

zephyr_link_libraries(-Wl,--wrap=fs_read -Wl,--wrap=fs_stat -Wl,--wrap=kfsw_fbo_clock_seconds
    -Wl,--wrap=kfsw_time_monotonic_ms)
```

## prj.conf
```kconfig
CONFIG_ZTEST=y
CONFIG_FLASH=y
CONFIG_FLASH_MAP=y
CONFIG_FILE_SYSTEM=y
CONFIG_FILE_SYSTEM_LITTLEFS=y
CONFIG_FILE_SYSTEM_MKFS=y
CONFIG_KFSW_STORAGE=y
CONFIG_KFSW_COMMAND=y
CONFIG_KFSW_EVENT=y
CONFIG_KFSW_FBO=y
CONFIG_KFSW_FBO_BYTES_MAX=512
CONFIG_KFSW_FBO_LINES_MAX=8
CONFIG_SYS_CLOCK_TICKS_PER_SEC=1000
```

## src/main.c
```c
#include <errno.h>
#include <string.h>
#include <zephyr/fs/fs.h>
#include <zephyr/storage/flash_map.h>
#include <zephyr/ztest.h>
#include <kfsw/platform/storage.h>
#include <kfsw/services/command.h>
#include <kfsw/services/fbo.h>

#define PROCEDURE "/kfsw/ftp/procedures/test"
static atomic_t commands;
static int fail_after = -1;
static bool hide_size;
static int64_t utc_values[8];
static size_t utc_count;
static size_t utc_read;
static int utc_error;
static bool expire_wait;

uint64_t __real_kfsw_time_monotonic_ms(void);
uint64_t __wrap_kfsw_time_monotonic_ms(void)
{
	return __real_kfsw_time_monotonic_ms() +
	       ((expire_wait && utc_read >= 2U) ? 1000U * CONFIG_KFSW_FBO_WAIT_MAX_S : 0U);
}

int __wrap_kfsw_fbo_clock_seconds(int64_t *seconds)
{
	if (utc_error != 0) {
		return utc_error;
	}
	*seconds = utc_values[MIN(utc_read, utc_count - 1U)];
	utc_read++;
	return (*seconds < 0) ? -ENODATA : 0;
}
static K_SEM_DEFINE(entered, 0, 1);
static K_SEM_DEFINE(release_handler, 0, 1);

ssize_t __real_fs_read(struct fs_file_t *file, void *data, size_t size);
int __real_fs_stat(const char *path, struct fs_dirent *entry);

ssize_t __wrap_fs_read(struct fs_file_t *file, void *data, size_t size)
{
	if (fail_after == 0) {
		return -EIO;
	}
	if (fail_after > 0) {
		fail_after--;
	}
	return __real_fs_read(file, data, size);
}

int __wrap_fs_stat(const char *path, struct fs_dirent *entry)
{
	int result = __real_fs_stat(path, entry);

	if (hide_size && (result == 0) && (strcmp(path, PROCEDURE) == 0)) {
		entry->size = 0;
	}
	return result;
}

static int handler(const struct kfsw_command_arg *args, size_t count,
		   const struct kfsw_command_source *source, struct kfsw_command_result *result)
{
	ARG_UNUSED(args);
	ARG_UNUSED(count);
	ARG_UNUSED(source);
	atomic_inc(&commands);
	result->status = KFSW_COMMAND_OK;
	return 0;
}

static int gate(const struct kfsw_command_arg *args, size_t count,
		const struct kfsw_command_source *source, struct kfsw_command_result *result)
{
	ARG_UNUSED(args);
	ARG_UNUSED(count);
	ARG_UNUSED(source);
	k_sem_give(&entered);
	if (k_sem_take(&release_handler, K_SECONDS(2)) != 0) {
		return -ETIMEDOUT;
	}
	result->status = KFSW_COMMAND_OK;
	return 0;
}

static void write_procedure(const char *text, size_t size)
{
	struct fs_file_t file;

	fs_file_t_init(&file);
	zassert_ok(fs_open(&file, PROCEDURE, FS_O_CREATE | FS_O_WRITE | FS_O_TRUNC));
	zassert_equal(fs_write(&file, text, size), size);
	zassert_ok(fs_close(&file));
}

static int completed(void)
{
	struct kfsw_fbo_status status;
	int64_t deadline = k_uptime_get() + 1000;

	do {
		zassert_ok(kfsw_fbo_get_status(&status));
		if (!status.running) {
			return status.last_result;
		}
		k_sleep(K_MSEC(1));
	} while (k_uptime_get() < deadline);
	zassert_unreachable("Procedure did not stop within one second");
	return -ETIMEDOUT;
}

static void run_text(const char *text, int expected)
{
	write_procedure(text, strlen(text));
	zassert_ok(kfsw_fbo_run("test"));
	zassert_equal(completed(), expected);
}

static void *setup(void)
{
	static const struct kfsw_command_definition definitions[] = {
		{.id = 1, .name = "count", .handler = handler},
		{.id = 2, .name = "gate", .handler = gate},
	};
	static const struct kfsw_command_definition_set set = {
		.commands = definitions,
		.count = ARRAY_SIZE(definitions),
	};
	const struct kfsw_command_definition_set *sets[] = {&set};
	const struct flash_area *area;

	zassert_ok(
		flash_area_open(DT_FIXED_PARTITION_ID(DT_CHOSEN(kfsw_storage_partition)), &area));
	zassert_ok(flash_area_flatten(area, 0, area->fa_size));
	flash_area_close(area);
	zassert_ok(kfsw_storage_init());
	zassert_ok(kfsw_storage_mount());
	zassert_ok(fs_mkdir("/kfsw/ftp"));
	zassert_ok(fs_mkdir("/kfsw/ftp/procedures"));
	zassert_ok(kfsw_command_init(sets, ARRAY_SIZE(sets)));
	zassert_ok(kfsw_fbo_init());
	return NULL;
}

static void before(void *fixture)
{
	utc_error = -ENODATA;
	utc_count = 0U;
	utc_read = 0U;
	expire_wait = false;
	ARG_UNUSED(fixture);
	atomic_set(&commands, 0);
	fail_after = -1;
	hide_size = false;
	k_sem_reset(&entered);
	k_sem_reset(&release_handler);
}

ZTEST(services_fbo, test_idle_stop_does_not_cancel_next_run)
{
	zassert_ok(kfsw_fbo_stop());
	run_text("# comment\n\ncount\ncount", 0);
	zassert_equal(atomic_get(&commands), 2);
}

ZTEST(services_fbo, test_stop_wakes_long_wait_even_when_errors_continue)
{
	const char text[] = "on-error continue\ngate\nwait 600\ncount\n";
	int64_t start;

	write_procedure(text, sizeof(text) - 1U);
	zassert_ok(kfsw_fbo_run("test"));
	zassert_ok(k_sem_take(&entered, K_SECONDS(1)));
	zassert_equal(kfsw_fbo_run("test"), -EBUSY);
	k_sem_give(&release_handler);
	k_sleep(K_MSEC(20));
	start = k_uptime_get();
	zassert_ok(kfsw_fbo_stop());
	zassert_equal(completed(), -ECANCELED);
	zassert_true(k_uptime_get() - start < 100);
	zassert_equal(atomic_get(&commands), 0);
	run_text("count\n", 0);
	zassert_equal(atomic_get(&commands), 1);
}

ZTEST(services_fbo, test_read_failure_does_not_execute_partial_line)
{
	fail_after = 5;
	run_text("count\n", -EIO);
	zassert_equal(atomic_get(&commands), 0);
}

ZTEST(services_fbo, test_guard_ranges_and_unsigned_sign)
{
	const char *invalid[] = {"if-event 65536 1 skip\ncount\n", "if-event 1 65536 skip\ncount\n",
				 "if-event -1 1 skip\ncount\n", "wait -0\ncount\n",
				 "wait 4294967296\ncount\n"};

	for (size_t i = 0; i < ARRAY_SIZE(invalid); i++) {
		run_text(invalid[i], -EINVAL);
	}
	zassert_equal(atomic_get(&commands), 0);
}

ZTEST(services_fbo, test_byte_limit_counts_comments_and_growth)
{
	char text[CONFIG_KFSW_FBO_BYTES_MAX + 2];

	memset(text, '\n', sizeof(text));
	write_procedure(text, sizeof(text));
	zassert_equal(kfsw_fbo_run("test"), -EFBIG);
	hide_size = true;
	zassert_ok(kfsw_fbo_run("test"));
	zassert_equal(completed(), -EFBIG);
	zassert_equal(atomic_get(&commands), 0);
}

ZTEST(services_fbo, test_continue_preserves_first_failure)
{
	run_text("on-error continue\nmissing\ncount\n", -ENOENT);
	zassert_equal(atomic_get(&commands), 1);
}

ZTEST(services_fbo, test_line_limit_is_reported)
{
	run_text("count\ncount\ncount\ncount\ncount\ncount\ncount\ncount\ncount\n", -E2BIG);
	zassert_equal(atomic_get(&commands), CONFIG_KFSW_FBO_LINES_MAX);
}

static void clock_script(const int64_t *values, size_t count)
{
	memcpy(utc_values, values, count * sizeof(*values));
	utc_count = count;
	utc_read = 0U;
	utc_error = 0;
}

ZTEST(services_fbo, test_utc_future_due_and_tolerance)
{
	const int64_t values[] = {100, 101, 102};

	clock_script(values, ARRAY_SIZE(values));
	run_text("wait-until 102 0\ncount\n", 0);
	zassert_equal(atomic_get(&commands), 1);
}

ZTEST(services_fbo, test_utc_forward_step_too_late_stops)
{
	const int64_t values[] = {100, 110};

	clock_script(values, ARRAY_SIZE(values));
	run_text("wait-until 102 1\ncount\n", -ETIME);
	zassert_equal(atomic_get(&commands), 0);
}

ZTEST(services_fbo, test_utc_clock_becomes_unset_while_waiting)
{
	const int64_t values[] = {100, -1};

	clock_script(values, ARRAY_SIZE(values));
	run_text("wait-until 102 0\ncount\n", -ENODATA);
	zassert_equal(atomic_get(&commands), 0);
}

ZTEST(services_fbo, test_utc_already_due_within_tolerance)
{
	const int64_t values[] = {103};

	clock_script(values, ARRAY_SIZE(values));
	run_text("wait-until 102 1\ncount\n", 0);
	zassert_equal(atomic_get(&commands), 1);
}

ZTEST(services_fbo, test_utc_backward_step_keeps_waiting)
{
	const int64_t values[] = {100, 90, 101, 102};

	clock_script(values, ARRAY_SIZE(values));
	run_text("wait-until 102 0\ncount\n", 0);
	zassert_equal(utc_read, 4);
	zassert_equal(atomic_get(&commands), 1);
}

ZTEST(services_fbo, test_utc_backward_step_cannot_exceed_monotonic_budget)
{
	const int64_t values[] = {100, 90};

	clock_script(values, ARRAY_SIZE(values));
	expire_wait = true;
	run_text("wait-until 102 0\ncount\n", -ETIMEDOUT);
	zassert_equal(atomic_get(&commands), 0);
}

ZTEST(services_fbo, test_utc_unset_clock_and_invalid_bounds)
{
	const char *invalid[] = {"wait-until 0 0\n",  "wait-until 2147483648 0\n",
				 "wait-until -1 0\n", "wait-until 102 -1\n",
				 "wait-until 102\n",  "wait-until 102 601\n"};
	const int64_t values[] = {100};

	run_text("wait-until 102 0\ncount\n", -ENODATA);
	clock_script(values, ARRAY_SIZE(values));
	run_text("wait-until 701 0\ncount\n", -ERANGE);
	for (size_t i = 0; i < ARRAY_SIZE(invalid); i++) {
		run_text(invalid[i], -EINVAL);
	}
	zassert_equal(atomic_get(&commands), 0);
}

ZTEST(services_fbo, test_stop_wakes_utc_wait_with_continue_policy)
{
	const char text[] = "on-error continue\nwait-until 102 0\ncount\n";
	const int64_t values[] = {100};

	clock_script(values, ARRAY_SIZE(values));
	write_procedure(text, strlen(text));
	zassert_ok(kfsw_fbo_run("test"));
	k_sleep(K_MSEC(30));
	zassert_ok(kfsw_fbo_stop());
	zassert_equal(completed(), -ECANCELED);
	zassert_equal(atomic_get(&commands), 0);
}

ZTEST_SUITE(services_fbo, NULL, setup, before, NULL, NULL);
```
