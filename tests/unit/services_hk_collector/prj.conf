## CMakeLists.txt
```
cmake_minimum_required(VERSION 3.20.0)

get_filename_component(KFSW_WORKSPACE_ROOT
    "${CMAKE_CURRENT_LIST_DIR}/../../../.."
    ABSOLUTE
)

list(APPEND ZEPHYR_EXTRA_MODULES
    "${KFSW_WORKSPACE_ROOT}/kfsw-platform"
    "${KFSW_WORKSPACE_ROOT}/kfsw-comms/third_party/libcsp"
    "${KFSW_WORKSPACE_ROOT}/kfsw-comms"
    "${KFSW_WORKSPACE_ROOT}/kfsw-services"
)

find_package(Zephyr REQUIRED HINTS $ENV{ZEPHYR_BASE})
project(kfsw_services_hk_collector_tests LANGUAGES C)

target_sources(app PRIVATE src/main.c)
target_link_libraries(app PRIVATE kfsw::services kfsw::comms)
```

## prj.conf
```kconfig
CONFIG_ZTEST=y

CONFIG_KFSW_PARAM=y

# The clock gate needs a wall clock, which needs CSP.
CONFIG_KFSW_CSP=y
CONFIG_KFSW_CSP_ADDRESS=7
CONFIG_KFSW_CSP_HOSTNAME="kfsw-hk-collector-test"
CONFIG_KFSW_CSP_KISS_UART=n

CONFIG_KFSW_HK=y
CONFIG_KFSW_HK_REPORTS=2
CONFIG_KFSW_HK_ENTRIES=8
CONFIG_KFSW_HK_HISTORY=4
CONFIG_KFSW_HK_SAMPLE_BYTES=32

# The floor bounds how short a period a test may ask for, and the cases below
# wait in real time, so it is set low to keep them quick.
CONFIG_KFSW_HK_PERIOD_FLOOR_MS=100
```

## src/main.c
```c
#include <string.h>

#include <zephyr/kernel.h>
#include <zephyr/sys/util.h>
#include <zephyr/ztest.h>

#include <kfsw/comms/csp.h>
#include <kfsw/services/hk.h>
#include <kfsw/services/parameter.h>

#define TEST_TABLE 30U

/*
 * The periodic collector and its two gates: the clock must be set and collection
 * enabled. These cases wait in real time; the period floor is lowered in
 * prj.conf.
 */

static uint16_t counter_u16 = 0x1234U;
static uint32_t counter_u32 = 0xAABBCCDDU;

static const struct kfsw_param_definition test_definitions[] = {
	{
		.offset = 0x00,
		.type = KFSW_PARAM_U16,
		.flags = KFSW_PARAM_FLAG_READ_ONLY,
		.name = "collector_test_u16",
		.value = &counter_u16,
	},
	{
		.offset = 0x02,
		.type = KFSW_PARAM_U32,
		.flags = KFSW_PARAM_FLAG_READ_ONLY,
		.name = "collector_test_u32",
		.value = &counter_u32,
	},
};

static const struct kfsw_param_definition_set test_set = {
	.table = TEST_TABLE,
	.name = "collectortest",
	.definitions = test_definitions,
	.count = ARRAY_SIZE(test_definitions),
};

static void set_clock(bool valid)
{
	/* Zero seconds is an unset clock. */
	struct kfsw_csp_clock clock = {.seconds = valid ? 1788000000 : 0, .nanoseconds = 0U};

	(void)kfsw_csp_clock_set(&clock);
}

static void define_report(uint8_t report)
{
	const struct kfsw_hk_entry entries[] = {
		{.node = KFSW_HK_NODE_LOCAL, .param_id = KFSW_PARAM_ID(TEST_TABLE, 0x00)},
		{.node = KFSW_HK_NODE_LOCAL, .param_id = KFSW_PARAM_ID(TEST_TABLE, 0x02)},
	};

	zassert_ok(kfsw_hk_define(report, entries, ARRAY_SIZE(entries)), "the report was refused");
}

static uint32_t collections(void)
{
	struct kfsw_hk_stats stats;

	kfsw_hk_get_stats(&stats);
	return stats.collections;
}

static void *collector_setup(void)
{
	static const struct kfsw_param_definition_set *const sets[] = {&test_set};

	zassert_ok(kfsw_param_init(sets, ARRAY_SIZE(sets)), "the parameter table did not start");
	zassert_ok(kfsw_hk_init(), "housekeeping did not start");
	zassert_ok(kfsw_hk_start(), "the collector did not start");
	return NULL;
}

static void collector_before(void *fixture)
{
	ARG_UNUSED(fixture);
	for (uint8_t report = 0U; report < CONFIG_KFSW_HK_REPORTS; report++) {
		(void)kfsw_hk_clear(report);
	}
	kfsw_hk_set_enabled(true);
	set_clock(false);
	/* Long enough for the thread to notice the state it is being left in. */
	k_sleep(K_MSEC(400));
}

ZTEST_SUITE(kfsw_hk_collector, NULL, collector_setup, collector_before, NULL, NULL);

/* Starting twice must not start a second thread. */
ZTEST(kfsw_hk_collector, test_starting_again_is_harmless)
{
	zassert_ok(kfsw_hk_start(), "starting an already running collector failed");
}

/*
 * Without the clock nothing is collected on a schedule.
 */
ZTEST(kfsw_hk_collector, test_nothing_is_collected_until_the_node_knows_the_time)
{
	uint32_t before;
	uint16_t depth = 0U;

	define_report(0U);
	zassert_ok(kfsw_hk_set_period(0U, CONFIG_KFSW_HK_PERIOD_FLOOR_MS),
		   "the period was refused");

	before = collections();
	k_sleep(K_MSEC(800));

	zassert_equal(collections(), before, "a node with no clock collected on a schedule");
	zassert_ok(kfsw_hk_depth(0U, &depth), "the report could not be read");
	zassert_equal(depth, 0U, "the ring filled while the clock was missing");
}

/* Manual collection must set the missing-clock flag. */
ZTEST(kfsw_hk_collector, test_collecting_by_hand_works_without_a_clock)
{
	struct kfsw_hk_sample sample;

	define_report(0U);
	zassert_ok(kfsw_hk_collect(0U), "an operator could not collect without a clock");
	zassert_ok(kfsw_hk_get(0U, 0U, &sample), "the sample was not kept");
	zassert_true((sample.flags & KFSW_HK_FLAG_CLOCK_UNSET) != 0U,
		     "a sample taken without a clock did not say so");
	zassert_equal(sample.seconds, 0U, "an unset clock produced a timestamp");
}

/* Setting the clock must start periodic collection. */
ZTEST(kfsw_hk_collector, test_the_schedule_starts_when_the_clock_arrives)
{
	uint32_t before;

	define_report(0U);
	zassert_ok(kfsw_hk_set_period(0U, CONFIG_KFSW_HK_PERIOD_FLOOR_MS),
		   "the period was refused");

	before = collections();
	k_sleep(K_MSEC(500));
	zassert_equal(collections(), before, "collection began before the clock was set");

	set_clock(true);
	k_sleep(K_MSEC(800));
	zassert_true(collections() > before, "the schedule did not start when the clock arrived");
}

ZTEST(kfsw_hk_collector, test_a_scheduled_sample_carries_the_time)
{
	struct kfsw_hk_sample sample;

	define_report(0U);
	set_clock(true);
	zassert_ok(kfsw_hk_set_period(0U, CONFIG_KFSW_HK_PERIOD_FLOOR_MS),
		   "the period was refused");
	k_sleep(K_MSEC(800));

	zassert_ok(kfsw_hk_get(0U, 0U, &sample), "the schedule produced no sample");
	zassert_true((sample.flags & KFSW_HK_FLAG_CLOCK_UNSET) == 0U,
		     "a sample taken with a clock said it had none");
	zassert_true(sample.seconds > 0U, "a timed sample carries no time");
}

/* A report with no period is collected only when asked, however long it sits. */
ZTEST(kfsw_hk_collector, test_a_report_without_a_period_is_left_alone)
{
	uint16_t depth = 0U;

	define_report(0U);
	set_clock(true);
	k_sleep(K_MSEC(800));

	zassert_ok(kfsw_hk_depth(0U, &depth), "the report could not be read");
	zassert_equal(depth, 0U, "a report with no period was collected anyway");
}

/*
 * Disabling stops the schedule and keeps the samples.
 */
ZTEST(kfsw_hk_collector, test_disabling_stops_the_schedule_and_keeps_what_was_collected)
{
	uint16_t depth_when_disabled = 0U;
	uint16_t depth_later = 0U;
	uint32_t before;

	define_report(0U);
	set_clock(true);
	zassert_ok(kfsw_hk_set_period(0U, CONFIG_KFSW_HK_PERIOD_FLOOR_MS),
		   "the period was refused");
	k_sleep(K_MSEC(600));
	zassert_ok(kfsw_hk_depth(0U, &depth_when_disabled), "the report could not be read");
	zassert_true(depth_when_disabled > 0U, "the schedule collected nothing to keep");

	kfsw_hk_set_enabled(false);
	k_sleep(K_MSEC(300));
	before = collections();
	k_sleep(K_MSEC(800));

	zassert_equal(collections(), before, "a disabled collector kept collecting");
	zassert_ok(kfsw_hk_depth(0U, &depth_later), "the report could not be read");
	zassert_equal(depth_later, depth_when_disabled,
		      "disabling the collector discarded what it had already collected");

	kfsw_hk_set_enabled(true);
	k_sleep(K_MSEC(800));
	zassert_true(collections() > before, "the collector did not resume when enabled again");
}

/* Two reports on their own schedules. */
ZTEST(kfsw_hk_collector, test_reports_keep_their_own_schedules)
{
	uint16_t fast = 0U;
	uint16_t slow = 0U;

	define_report(0U);
	define_report(1U);
	set_clock(true);
	zassert_ok(kfsw_hk_set_period(0U, CONFIG_KFSW_HK_PERIOD_FLOOR_MS),
		   "the period was refused");
	zassert_ok(kfsw_hk_set_period(1U, CONFIG_KFSW_HK_PERIOD_FLOOR_MS * 6U),
		   "the period was refused");
	k_sleep(K_MSEC(900));

	zassert_ok(kfsw_hk_depth(0U, &fast), "the fast report could not be read");
	zassert_ok(kfsw_hk_depth(1U, &slow), "the slow report could not be read");
	zassert_true(fast > slow, "both reports collected at the same rate");
}
```
