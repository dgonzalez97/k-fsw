## tests/unit/app_csp_liveness/testcase.yaml
```yaml
tests:
  kfsw.app.csp_liveness:
    tags:
      - unit
      - app
      - health
      - csp
    platform_allow:
      - native_sim/native/64
    integration_platforms:
      - native_sim/native/64
  kfsw.app.csp_liveness.receivers:
    tags: [unit, app, health, csp]
    platform_allow: [native_sim/native/64]
    integration_platforms: [native_sim/native/64]
    extra_configs:
      - CONFIG_KFSW_TEST_RECEIVERS=y
      - CONFIG_KFSW_HEALTH_INTERVAL_MS=50
  kfsw.app.csp_liveness.unopened:
    tags: [unit, app, health, csp]
    platform_allow: [native_sim/native/64]
    integration_platforms: [native_sim/native/64]
    extra_configs:
      - CONFIG_KFSW_TEST_RECEIVERS=y
      - CONFIG_KFSW_TEST_RECEIVERS_UNOPENED=y
      - CONFIG_KFSW_HEALTH_INTERVAL_MS=50
```

## tests/unit/comms_uart_validation/testcase.yaml
```yaml
---
tests:
  kfsw.comms.uart_duplicate_name:
    tags:
      - unit
      - comms
      - csp
      - uart
      - routing
    platform_allow:
      - native_sim/native/64
    integration_platforms:
      - native_sim/native/64
  kfsw.comms.uart_duplicate_name.csp1:
    tags:
      - unit
      - comms
      - csp
      - uart
      - routing
    platform_allow:
      - native_sim/native/64
    integration_platforms:
      - native_sim/native/64
    extra_configs:
      - CONFIG_KFSW_CSP_VERSION_1=y
  kfsw.comms.uart_open.success:
    tags: [unit, comms, csp, uart]
    platform_allow: [native_sim/native/64]
    integration_platforms: [native_sim/native/64]
    extra_args:
      - UART_OPEN_FAILURE=0
      - EXTRA_DTC_OVERLAY_FILE=partial.overlay
  kfsw.comms.uart_open.first:
    tags: [unit, comms, csp, uart]
    platform_allow: [native_sim/native/64]
    integration_platforms: [native_sim/native/64]
    extra_args:
      - UART_OPEN_FAILURE=1
      - EXTRA_DTC_OVERLAY_FILE=partial.overlay
  kfsw.comms.uart_open.second:
    tags: [unit, comms, csp, uart]
    platform_allow: [native_sim/native/64]
    integration_platforms: [native_sim/native/64]
    extra_args:
      - UART_OPEN_FAILURE=2
      - EXTRA_DTC_OVERLAY_FILE=partial.overlay
  kfsw.comms.uart_open.codec_attach:
    tags: [unit, comms, csp, uart]
    platform_allow: [native_sim/native/64]
    integration_platforms: [native_sim/native/64]
    extra_args:
      - UART_OPEN_FAILURE=3
      - EXTRA_DTC_OVERLAY_FILE=partial.overlay
    extra_configs:
      - CONFIG_KFSW_CSP_UART_CODEC=y
  kfsw.comms.uart_open.codec_check:
    tags: [unit, comms, csp, uart]
    platform_allow: [native_sim/native/64]
    integration_platforms: [native_sim/native/64]
    extra_args:
      - UART_OPEN_FAILURE=4
      - EXTRA_DTC_OVERLAY_FILE=partial.overlay
    extra_configs:
      - CONFIG_KFSW_CSP_UART_CODEC=y
```

## tests/unit/services_health_fault/testcase.yaml
```yaml
tests:
  kfsw.services.health_fault:
    tags: [unit, services, health]
    platform_allow: [native_sim/native, native_sim/native/64]
    integration_platforms: [native_sim/native, native_sim/native/64]
```

## tests/unit/services_hk_persistence/testcase.yaml
```yaml
---
tests:
  kfsw.services.hk.persistence:
    tags:
      - unit
      - services
      - hk
      - littlefs
    platform_allow:
      - native_sim/native
      - native_sim/native/64
    integration_platforms:
      - native_sim/native
      - native_sim/native/64
  kfsw.services.hk.persistence.csp1:
    tags:
      - unit
      - services
      - hk
      - littlefs
    platform_allow:
      - native_sim/native
      - native_sim/native/64
    integration_platforms:
      - native_sim/native
      - native_sim/native/64
    extra_configs:
      - CONFIG_KFSW_CSP_VERSION_1=y
```

## west.yml
```yaml
manifest:
  version: "1.2"
  group-filter: [-host-tools]

  remotes:
    - name: zephyrproject
      url-base: https://github.com/zephyrproject-rtos

    - name: kfsw
      url-base: https://github.com/dgonzalez97

  projects:
    - name: kfsw-csp-tools
      remote: kfsw
      revision: 2c85fb2a9aad0edc9556d86d5ad5d9aa89786602
      path: tools/kfsw-csp-tools
      groups: [host-tools]

    - name: zephyr
      remote: zephyrproject
      revision: v4.4.0
      path: zephyr
      import:
        name-allowlist:
          # Cortex-M core and the three supported MCU families.
          - cmsis_6
          - hal_stm32
          - hal_nxp
          - hal_rpi_pico
          # Reference compositions and optional MCUboot/encrypted-radio profiles.
          - littlefs
          - picolibc
          - mcuboot
          - mbedtls
          - tf-psa-crypto

    - name: kfsw-platform
      remote: kfsw
      revision: 2f325925a476794878676ea69b118d778887d16f
      path: kfsw-platform

    - name: kfsw-services
      remote: kfsw
      revision: 9341e0af8e91cf958aff3c436b5ca446bce8f7c7
      path: kfsw-services

    - name: kfsw-comms
      remote: kfsw
      revision: c40f89215da20e50d1efb7ffb8ec385c0cdb266b
      path: kfsw-comms

    - name: kfsw-modules
      remote: kfsw
      revision: 054e74a161a95b51879c5b9f8549be5658683e3c
      path: kfsw-modules

    - name: libcsp
      remote: kfsw
      repo-path: kfsw-libcsp
      revision: cb0bbc14de1090e00771e4f3493086a46e696989
      path: kfsw-comms/third_party/libcsp

    - name: libparam
      remote: kfsw
      repo-path: kfsw-libparam
      revision: 1e5fbb29ef0e9f9b1d3b54219cc39246b39d000a
      path: kfsw-services/third_party/libparam

  self:
    path: k-fsw
```
