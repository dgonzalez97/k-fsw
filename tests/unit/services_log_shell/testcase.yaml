## tests/unit/services_log_shell/testcase.yaml
```yaml
common:
  tags: [unit, services, log, shell]
  platform_allow: [native_sim/native/64]
  integration_platforms: [native_sim/native/64]
tests:
  kfsw.services.log_shell.disabled: {}
  kfsw.services.log_shell.enabled:
    extra_configs:
      - CONFIG_KFSW_LOG_SHELL=y
```

## tests/unit/services_param/testcase.yaml
```yaml
---
tests:
  kfsw.services.param:
    tags:
      - unit
      - services
      - param
    platform_allow:
      - native_sim/native/64
    integration_platforms:
      - native_sim/native/64
  kfsw.services.param_csp:
    tags:
      - unit
      - services
      - param
      - csp
    extra_configs:
      - CONFIG_KFSW_CSP=y
      - CONFIG_KFSW_CSP_ADDRESS=7
      - CONFIG_KFSW_CSP_HOSTNAME="kfsw-param-test"
      - CONFIG_KFSW_CSP_KISS_UART=n
      - CONFIG_KFSW_PARAM_CSP=y
    platform_allow:
      - native_sim/native/64
    integration_platforms:
      - native_sim/native/64
```

## tests/unit/services_param_fbo/testcase.yaml
```yaml
tests:
  kfsw.services.param_fbo:
    tags: [unit, services, param, fbo, csp]
    platform_allow: [native_sim/native/64]
    integration_platforms: [native_sim/native/64]
```

## tests/unit/services_param_float/testcase.yaml
```yaml
---
common:
  tags: [unit, services, param]
  platform_allow: [native_sim/native/64]
  integration_platforms: [native_sim/native/64]
tests:
  kfsw.services.param_float: {}
  kfsw.services.param_float.disabled:
    extra_configs:
      - CONFIG_KFSW_PARAM_FLOAT=n
```

## tests/unit/services_param_persistence/testcase.yaml
```yaml
tests:
  kfsw.services.param_persistence:
    tags:
      - unit
      - services
      - param
      - storage
    platform_allow:
      - native_sim/native/64
    integration_platforms:
      - native_sim/native/64
```

## tests/unit/services_param_strings/testcase.yaml
```yaml
---
tests:
  kfsw.services.param_strings:
    tags:
      - unit
      - services
      - param
      - strings
    platform_allow:
      - native_sim/native/64
    integration_platforms:
      - native_sim/native/64
```

## tests/unit/services_param_worker/testcase.yaml
```yaml
tests:
  kfsw.services.param_worker:
    tags: [unit, services, param, csp]
    platform_allow: [native_sim/native/64]
    integration_platforms: [native_sim/native/64]
  kfsw.services.param_worker.local_only:
    tags: [unit, services, param, csp]
    platform_allow: [native_sim/native/64]
    integration_platforms: [native_sim/native/64]
    extra_args: EXTRA_CFLAGS=-DKFSW_TEST_LOCAL_ONLY=1
  kfsw.services.param_worker.led:
    tags: [unit, services, param, csp, gpio]
    platform_allow: [native_sim/native/64]
    integration_platforms: [native_sim/native/64]
    extra_configs:
      - CONFIG_GPIO=y
      - CONFIG_GPIO_EMUL=y
      - CONFIG_KFSW_BOTON_TEST=y
      - CONFIG_KFSW_BOTON_TEST_LED_GPIO=y
      - CONFIG_KFSW_BOTON_TEST_SHELL=n
  kfsw.services.param_worker.apply:
    tags: [unit, services, param, csp]
    platform_allow: [native_sim/native/64]
    integration_platforms: [native_sim/native/64]
    extra_args: EXTRA_CFLAGS=-DKFSW_TEST_APPLY=1
```

## tests/unit/services_remexec/testcase.yaml
```yaml
---
tests:
  kfsw.services.remexec:
    tags:
      - unit
      - services
      - remexec
    platform_allow:
      - native_sim/native/64
    integration_platforms:
      - native_sim/native/64
```

## tests/unit/services_remexec_empty/testcase.yaml
```yaml
---
tests:
  kfsw.services.remexec.empty:
    tags:
      - unit
      - services
      - remexec
    platform_allow:
      - native_sim/native/64
    integration_platforms:
      - native_sim/native/64
```

## tests/unit/services_resmon/testcase.yaml
```yaml
---
tests:
  kfsw.services.resmon:
    tags:
      - unit
      - services
      - resmon
    platform_allow:
      - native_sim/native/64
    integration_platforms:
      - native_sim/native/64
```

## tests/unit/services_scrub/testcase.yaml
```yaml
tests:
  kfsw.services.scrub:
    tags:
      - unit
      - services
      - scrub
    platform_allow:
      - native_sim/native/64
    integration_platforms:
      - native_sim/native/64
```

## tests/unit/services_table/testcase.yaml
```yaml
tests:
  kfsw.services.table:
    tags:
      - unit
      - services
      - param
      - table
    platform_allow:
      - native_sim/native
      - native_sim/native/64
    integration_platforms:
      - native_sim/native
      - native_sim/native/64
  kfsw.services.table.text_persistence:
    tags: [unit, services, param, storage]
    platform_allow: [native_sim/native, native_sim/native/64]
    integration_platforms: [native_sim/native, native_sim/native/64]
    extra_configs:
      - CONFIG_KFSW_PARAM_PERSISTENCE=y
    extra_args: EXTRA_CFLAGS=-DKFSW_TEST_TEXT_PERSIST=1
```

## tests/unit/uart_codec/testcase.yaml
```yaml
tests:
  kfsw.comms.uart_codec:
    tags: [unit, comms, uart]
    platform_allow: [native_sim/native/64]
    integration_platforms: [native_sim/native/64]
```

## west.yml
```yaml
manifest:
  version: "1.2"
  group-filter: [-host-tools]

  remotes:
    - name: zephyrproject
      url-base: https://github.com/zephyrproject-rtos

    - name: kfsw
      url-base: https://github.com/dgonzalez97

  projects:
    - name: kfsw-csp-tools
      remote: kfsw
      revision: 2c85fb2a9aad0edc9556d86d5ad5d9aa89786602
      path: tools/kfsw-csp-tools
      groups: [host-tools]

    - name: zephyr
      remote: zephyrproject
      revision: v4.4.0
      path: zephyr
      import:
        name-allowlist:
          # Cortex-M core and the three supported MCU families.
          - cmsis_6
          - hal_stm32
          - hal_nxp
          - hal_rpi_pico
          # Reference compositions and optional MCUboot/encrypted-radio profiles.
          - littlefs
          - picolibc
          - mcuboot
          - mbedtls
          - tf-psa-crypto

    - name: kfsw-platform
      remote: kfsw
      revision: 3fb9e44fb0fa74ad937dd769c7ae154ac229f95d
      path: kfsw-platform

    - name: kfsw-services
      remote: kfsw
      revision: acbe152f325e4e95a09bd58e20af52311b3db8fe
      path: kfsw-services

    - name: kfsw-comms
      remote: kfsw
      revision: 7050a8950bfe4ee6d40fa4625c157d748cab7fe8
      path: kfsw-comms

    - name: kfsw-modules
      remote: kfsw
      revision: 99d0db9bcef277e901725bd890e1f4852c61c3e7
      path: kfsw-modules

    - name: libcsp
      remote: kfsw
      repo-path: kfsw-libcsp
      revision: b57345d44522ef34fe769099665bba2de5d01e48
      path: kfsw-comms/third_party/libcsp

    - name: libparam
      remote: kfsw
      repo-path: kfsw-libparam
      revision: 1e5fbb29ef0e9f9b1d3b54219cc39246b39d000a
      path: kfsw-services/third_party/libparam

  self:
    path: k-fsw
```
