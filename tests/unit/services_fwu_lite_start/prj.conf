## CMakeLists.txt
```
cmake_minimum_required(VERSION 3.20.0)

get_filename_component(KFSW_WORKSPACE_ROOT
    "${CMAKE_CURRENT_LIST_DIR}/../../../.."
    ABSOLUTE
)

list(APPEND ZEPHYR_EXTRA_MODULES
    "${KFSW_WORKSPACE_ROOT}/kfsw-platform"
    "${KFSW_WORKSPACE_ROOT}/kfsw-comms/third_party/libcsp"
    "${KFSW_WORKSPACE_ROOT}/kfsw-comms"
    "${KFSW_WORKSPACE_ROOT}/kfsw-services"
)

set(CSP_USE_RDP ON CACHE BOOL "" FORCE)
set(CSP_REPRODUCIBLE_BUILDS ON CACHE BOOL "" FORCE)
find_package(Zephyr REQUIRED HINTS $ENV{ZEPHYR_BASE})
project(kfsw_services_fwu_lite_start_tests LANGUAGES C)

target_sources(app PRIVATE src/main.c)
target_link_libraries(app PRIVATE kfsw::services kfsw::comms)
```

## prj.conf
```kconfig
CONFIG_ZTEST=y

CONFIG_FLASH=y
CONFIG_FLASH_MAP=y
CONFIG_KFSW_FWU=y
CONFIG_KFSW_FWU_MCUBOOT=n
CONFIG_KFSW_FWU_SLOT_OFFSET_SECTORS=1

CONFIG_KFSW_FWU_LITE=y
CONFIG_KFSW_FWU_LITE_BLOCK_SIZE=192
# The protocol is tested without a transport.
CONFIG_KFSW_FWU_LITE_CSP=y
CONFIG_KFSW_CSP=y
CONFIG_KFSW_CSP_KISS_UART=n
CONFIG_KFSW_LOG_HISTORY=y
CONFIG_KFSW_LOG_REMOTE=y
```

## src/main.c
```c
#include <errno.h>
#include <zephyr/ztest.h>
#include <csp/csp.h>
#include <kfsw/comms/csp.h>
#include <kfsw/services/fwu_lite.h>
#include <kfsw/services/log_remote.h>

ZTEST(fwu_lite_start, test_occupied_port_fails_synchronously_and_retry_works)
{
	static csp_socket_t occupied;

	zassert_equal(kfsw_fwu_lite_server_start(), -EACCES);
	zassert_ok(kfsw_csp_init());
	zassert_ok(kfsw_csp_start());
	zassert_ok(kfsw_log_remote_server_start());
	zassert_ok(csp_listen(&occupied, 1));
	zassert_ok(csp_bind(&occupied, CONFIG_KFSW_FWU_LITE_CSP_PORT));
	zassert_equal(kfsw_fwu_lite_server_start(), -EADDRINUSE);
	zassert_ok(csp_socket_close(&occupied));
	zassert_ok(kfsw_fwu_lite_server_start());
	zassert_equal(kfsw_fwu_lite_server_start(), -EALREADY);
}

ZTEST_SUITE(fwu_lite_start, NULL, NULL, NULL, NULL, NULL);
```
