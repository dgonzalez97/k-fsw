## CMakeLists.txt
```
cmake_minimum_required(VERSION 3.20.0)

get_filename_component(KFSW_WORKSPACE_ROOT
    "${CMAKE_CURRENT_LIST_DIR}/../../../.."
    ABSOLUTE
)

list(APPEND ZEPHYR_EXTRA_MODULES
    "${KFSW_WORKSPACE_ROOT}/kfsw-platform"
    "${KFSW_WORKSPACE_ROOT}/kfsw-comms/third_party/libcsp"
    "${KFSW_WORKSPACE_ROOT}/kfsw-comms"
    "${KFSW_WORKSPACE_ROOT}/kfsw-services"
)

find_package(Zephyr REQUIRED HINTS $ENV{ZEPHYR_BASE})
project(kfsw_services_ftp_transfer_tests LANGUAGES C)

target_sources(app PRIVATE src/main.c)
target_include_directories(app PRIVATE "${KFSW_WORKSPACE_ROOT}/kfsw-services/src/ftp")
target_link_libraries(app PRIVATE kfsw::services kfsw::comms)

# Wrap ftp_link.h calls to test timeouts, repeated offsets and failed sends.
zephyr_link_libraries(
    -Wl,--wrap=kfsw_ftp_link_send
    -Wl,--wrap=kfsw_ftp_link_receive
    -Wl,--wrap=kfsw_ftp_link_release
)

zephyr_link_libraries(-Wl,--wrap=flash_area_flatten)
```

## prj.conf
```kconfig
CONFIG_ZTEST=y

CONFIG_FLASH=y
CONFIG_FLASH_MAP=y
CONFIG_FILE_SYSTEM=y
CONFIG_FILE_SYSTEM_LITTLEFS=y
CONFIG_FILE_SYSTEM_MKFS=y
CONFIG_KFSW_STORAGE=y

CONFIG_KFSW_CSP=y
CONFIG_KFSW_CSP_ADDRESS=7
CONFIG_KFSW_CSP_HOSTNAME="kfsw-ftp-transfer-test"
CONFIG_KFSW_CSP_KISS_UART=n
CONFIG_KFSW_FTP=y
CONFIG_KFSW_FTP_TIMEOUT_MS=1000

# The update service is enabled to test the reserved upload path in the
# transfer layer.
CONFIG_KFSW_FWU=y
CONFIG_KFSW_FWU_MCUBOOT=n
```

## boards/native_sim_native_64.overlay
```dts
/ {
	chosen {
		kfsw,fwu-partition = &slot1_partition;
		kfsw,storage-partition = &storage_partition;
	};
};

&storage_partition {
	label = "kfsw-ftp-transfer-test";
	reg = <0x000fc000 0x00010000>;
};
```

## src/main.c
```c
/*
 * FTP send and receive loops through a fake transport, for cases a real peer
 * doesn't produce: replayed offsets, dropped links and failed sends.
 */

#include <errno.h>
#include <stdbool.h>
#include <stdint.h>
#include <string.h>

#include <zephyr/fff.h>
#include <zephyr/fs/fs.h>
#include <zephyr/storage/flash_map.h>
#include <zephyr/sys/crc.h>
#include <zephyr/ztest.h>

#include <kfsw/platform/storage.h>
#include <kfsw/services/ftp.h>

#include "ftp_internal.h"
#include "ftp_link.h"

DEFINE_FFF_GLOBALS;

#define STORAGE_PARTITION_NODE DT_CHOSEN(kfsw_storage_partition)
#define TEST_SINK_PATH KFSW_FTP_STORAGE_ROOT "/transfer.part"
#define TEST_SOURCE_PATH KFSW_FTP_STORAGE_ROOT "/transfer.src"
/* TEST_SINK_PATH is this target's partial, which is what resume reads. */
#define TEST_TARGET_PATH KFSW_FTP_STORAGE_ROOT "/transfer"
#define TEST_NOTE_PATH KFSW_FTP_STORAGE_ROOT "/transfer.part.map"
#define TEST_REQUEST_ID 0x51EDU

FAKE_VALUE_FUNC(int, __wrap_kfsw_ftp_link_send, struct kfsw_ftp_link *,
		const struct kfsw_ftp_message *);
FAKE_VALUE_FUNC(int, __wrap_kfsw_ftp_link_receive, struct kfsw_ftp_link *,
		struct kfsw_ftp_link_frame *);
FAKE_VOID_FUNC(__wrap_kfsw_ftp_link_release, struct kfsw_ftp_link_frame *);

/* One scripted inbound message per call. */
#define SCRIPT_MAX 4
static struct kfsw_ftp_message scripted[SCRIPT_MAX];
static int scripted_result[SCRIPT_MAX];
static size_t scripted_count;
static size_t scripted_index;

static uint8_t payload[3][8];

static struct kfsw_ftp_link link_stub;
static struct kfsw_ftp_workspace workspace;
static struct kfsw_ftp_transfer transfer;
static int firmware_erase_error;

int __real_flash_area_flatten(const struct flash_area *area, off_t offset, size_t size);

int __wrap_flash_area_flatten(const struct flash_area *area, off_t offset, size_t size)
{
	if ((area->fa_id == DT_FIXED_PARTITION_ID(DT_CHOSEN(kfsw_fwu_partition))) &&
	    (firmware_erase_error != 0)) {
		return firmware_erase_error;
	}
	return __real_flash_area_flatten(area, offset, size);
}

static int deliver_scripted(struct kfsw_ftp_link *link, struct kfsw_ftp_link_frame *frame)
{
	ARG_UNUSED(link);

	if (scripted_index >= scripted_count) {
		return -ENODATA;
	}
	if (scripted_result[scripted_index] != 0) {
		return scripted_result[scripted_index++];
	}
	memset(frame, 0, sizeof(*frame));
	frame->message = scripted[scripted_index++];
	return 0;
}

/* A valid message, so each test only changes the field it checks. */
static struct kfsw_ftp_message good_message(uint32_t offset, size_t which, uint32_t total,
					    uint32_t crc)
{
	struct kfsw_ftp_message message = {
		.opcode = KFSW_FTP_OP_PUT_DATA,
		.request_id = TEST_REQUEST_ID,
		.offset = offset,
		.total_size = total,
		.crc32 = crc,
		.data = payload[which],
		.data_size = (uint16_t)sizeof(payload[which]),
	};

	return message;
}

static void erase_storage_partition(void)
{
	const struct flash_area *area;

	zassert_ok(flash_area_open(DT_FIXED_PARTITION_ID(STORAGE_PARTITION_NODE), &area));
	zassert_ok(flash_area_flatten(area, 0, area->fa_size));
	flash_area_close(area);
}

static void *transfer_setup(void)
{
	erase_storage_partition();
	zassert_ok(kfsw_storage_init());
	zassert_ok(kfsw_storage_mount());
	zassert_ok(kfsw_ftp_init());

	for (size_t index = 0U; index < ARRAY_SIZE(payload); index++) {
		memset(payload[index], (int)(0xA0U + index), sizeof(payload[index]));
	}
	return NULL;
}

static void reset_transfer(void *fixture)
{
	struct kfsw_fwu_status status;

	ARG_UNUSED(fixture);
	firmware_erase_error = 0;
	zassert_ok(kfsw_fwu_get_status(&status));
	if (status.handle.generation != 0U) {
		zassert_ok(kfsw_fwu_session_abort(&status.handle, &status));
	}

	RESET_FAKE(__wrap_kfsw_ftp_link_send);
	RESET_FAKE(__wrap_kfsw_ftp_link_receive);
	RESET_FAKE(__wrap_kfsw_ftp_link_release);
	FFF_RESET_HISTORY();

	memset(scripted, 0, sizeof(scripted));
	memset(scripted_result, 0, sizeof(scripted_result));
	scripted_count = 0U;
	scripted_index = 0U;

	memset(&transfer, 0, sizeof(transfer));
	transfer.link = &link_stub;
	transfer.workspace = &workspace;
	transfer.request_id = TEST_REQUEST_ID;
	transfer.data_opcode = KFSW_FTP_OP_PUT_DATA;

	__wrap_kfsw_ftp_link_receive_fake.custom_fake = deliver_scripted;
	(void)fs_unlink(TEST_SINK_PATH);
	(void)fs_unlink(TEST_SOURCE_PATH);
	(void)fs_unlink(TEST_TARGET_PATH);
	(void)fs_unlink(TEST_NOTE_PATH);
}

ZTEST_SUITE(services_ftp_transfer, NULL, transfer_setup, reset_transfer, NULL, NULL);

ZTEST(services_ftp_transfer, test_receive_writes_every_chunk_and_checksums_them)
{
	const uint32_t total = (uint32_t)(2U * sizeof(payload[0]));
	uint32_t expected_crc = 0U;
	struct fs_dirent info;

	expected_crc = crc32_ieee_update(expected_crc, payload[0], sizeof(payload[0]));
	expected_crc = crc32_ieee_update(expected_crc, payload[1], sizeof(payload[1]));

	transfer.total_size = total;
	transfer.crc32 = 0U;
	scripted[0] = good_message(0U, 0U, total, 0U);
	scripted[1] = good_message((uint32_t)sizeof(payload[0]), 1U, total, 0U);
	scripted_count = 2U;

	zassert_ok(kfsw_ftp_transfer_open_sink(&transfer, TEST_SINK_PATH));
	zassert_ok(kfsw_ftp_transfer_receive(&transfer));
	zassert_ok(fs_close(&transfer.file));

	zassert_equal(transfer.offset, total, "every byte received should advance the offset");
	zassert_equal(transfer.actual_crc32, expected_crc,
		      "the running checksum should cover the bytes that arrived");
	zassert_ok(fs_stat(TEST_SINK_PATH, &info));
	zassert_equal((uint32_t)info.size, total, "the file should hold what was received");
}

/* A pass ends mid-upload; the next one sends only what is missing. */
ZTEST(services_ftp_transfer, test_an_interrupted_upload_is_continued_from_its_partial)
{
	const uint32_t chunk = (uint32_t)sizeof(payload[0]);
	const uint32_t total = 3U * chunk;
	uint32_t whole_crc = 0U;
	uint32_t resume_offset = 0U;
	uint32_t resume_crc = 0U;
	struct fs_dirent info;

	for (size_t index = 0U; index < 3U; index++) {
		whole_crc = crc32_ieee_update(whole_crc, payload[index], chunk);
	}

	/* The first attempt: one chunk arrives, then the link stops. */
	transfer.total_size = total;
	transfer.crc32 = whole_crc;
	scripted[0] = good_message(0U, 0U, total, whole_crc);
	scripted_result[1] = -ETIMEDOUT;
	scripted[2] = good_message(chunk, 1U, total, whole_crc);
	scripted[3] = good_message(2U * chunk, 2U, total, whole_crc);
	scripted_count = 4U;

	zassert_ok(kfsw_ftp_partial_note_write(TEST_TARGET_PATH, total, whole_crc));
	zassert_ok(kfsw_ftp_transfer_open_sink(&transfer, TEST_SINK_PATH));
	zassert_equal(kfsw_ftp_transfer_receive(&transfer), -ETIMEDOUT);
	zassert_equal(
		kfsw_ftp_transfer_finish(&transfer, TEST_TARGET_PATH, TEST_SINK_PATH, -ETIMEDOUT),
		-ETIMEDOUT);

	/* The partial survived the failure, and the target was not created. */
	zassert_ok(fs_stat(TEST_SINK_PATH, &info));
	zassert_equal((uint32_t)info.size, chunk);
	zassert_equal(fs_stat(TEST_TARGET_PATH, &info), -ENOENT);

	zassert_ok(kfsw_ftp_partial_resume_point(TEST_TARGET_PATH, &workspace, total, whole_crc,
						 &resume_offset, &resume_crc));
	zassert_equal(resume_offset, chunk, "the partial's own size is the resume point");
	zassert_equal(resume_crc, crc32_ieee(payload[0], chunk));

	/* The second attempt starts where the first stopped. The script continues
	 * from where the first attempt left it, so the partial is left alone.
	 */
	memset(&transfer, 0, sizeof(transfer));
	transfer.link = &link_stub;
	transfer.workspace = &workspace;
	transfer.request_id = TEST_REQUEST_ID;
	transfer.data_opcode = KFSW_FTP_OP_PUT_DATA;
	transfer.total_size = total;
	transfer.crc32 = whole_crc;
	transfer.offset = resume_offset;
	transfer.actual_crc32 = resume_crc;

	zassert_ok(kfsw_ftp_transfer_open_sink(&transfer, TEST_SINK_PATH));
	zassert_ok(kfsw_ftp_transfer_receive(&transfer));
	zassert_equal(transfer.offset, total);
	zassert_equal(transfer.actual_crc32, whole_crc,
		      "the checksum must cover the bytes from both attempts");
	zassert_ok(kfsw_ftp_transfer_finish(&transfer, TEST_TARGET_PATH, TEST_SINK_PATH, 0));

	/* Committed whole, and nothing left behind. */
	zassert_ok(fs_stat(TEST_TARGET_PATH, &info));
	zassert_equal((uint32_t)info.size, total);
	zassert_equal(fs_stat(TEST_SINK_PATH, &info), -ENOENT);
	zassert_equal(fs_stat(TEST_NOTE_PATH, &info), -ENOENT);
}

ZTEST(services_ftp_transfer, test_a_partial_of_another_file_is_not_continued)
{
	const uint32_t chunk = (uint32_t)sizeof(payload[0]);
	const uint32_t total = 2U * chunk;
	uint32_t offset = UINT32_MAX;
	uint32_t crc = UINT32_MAX;

	/* No note at all. */
	zassert_ok(kfsw_ftp_partial_resume_point(TEST_TARGET_PATH, &workspace, total, 0x1234U,
						 &offset, &crc));
	zassert_equal(offset, 0U);
	zassert_equal(crc, 0U);

	/* A partial exists and its note is valid, but for a different file. */
	transfer.total_size = total;
	scripted[0] = good_message(0U, 0U, total, 0U);
	scripted_count = 1U;
	zassert_ok(kfsw_ftp_partial_note_write(TEST_TARGET_PATH, total, 0x1234U));
	zassert_ok(kfsw_ftp_transfer_open_sink(&transfer, TEST_SINK_PATH));
	/* One chunk of two, so the script runs dry and the partial stays partial. */
	zassert_equal(kfsw_ftp_transfer_receive(&transfer), -ENODATA);
	zassert_ok(fs_close(&transfer.file));

	zassert_ok(kfsw_ftp_partial_resume_point(TEST_TARGET_PATH, &workspace, total, 0x4321U,
						 &offset, &crc));
	zassert_equal(offset, 0U, "a different checksum means a different file");
	zassert_ok(kfsw_ftp_partial_resume_point(TEST_TARGET_PATH, &workspace, total + 1U, 0x1234U,
						 &offset, &crc));
	zassert_equal(offset, 0U, "a different size means a different file");

	/* Matching again, and then with the note damaged. */
	zassert_ok(kfsw_ftp_partial_resume_point(TEST_TARGET_PATH, &workspace, total, 0x1234U,
						 &offset, &crc));
	zassert_equal(offset, chunk);

	struct fs_file_t note;
	uint8_t damaged = 0xFFU;

	fs_file_t_init(&note);
	zassert_ok(fs_open(&note, TEST_NOTE_PATH, FS_O_WRITE));
	zassert_equal(fs_write(&note, &damaged, sizeof(damaged)), (ssize_t)sizeof(damaged));
	zassert_ok(fs_close(&note));
	zassert_ok(kfsw_ftp_partial_resume_point(TEST_TARGET_PATH, &workspace, total, 0x1234U,
						 &offset, &crc));
	zassert_equal(offset, 0U, "a note that does not check out is not trusted");
}

ZTEST(services_ftp_transfer, test_every_received_frame_is_released_exactly_once)
{
	const uint32_t total = (uint32_t)(2U * sizeof(payload[0]));

	transfer.total_size = total;
	scripted[0] = good_message(0U, 0U, total, 0U);
	scripted[1] = good_message((uint32_t)sizeof(payload[0]), 1U, total, 0U);
	scripted_count = 2U;

	zassert_ok(kfsw_ftp_transfer_open_sink(&transfer, TEST_SINK_PATH));
	zassert_ok(kfsw_ftp_transfer_receive(&transfer));
	zassert_ok(fs_close(&transfer.file));

	zassert_equal(__wrap_kfsw_ftp_link_release_fake.call_count,
		      __wrap_kfsw_ftp_link_receive_fake.call_count,
		      "a frame that was taken should be given back");
}

ZTEST(services_ftp_transfer, test_a_link_that_stops_answering_ends_the_receive)
{
	const uint32_t total = (uint32_t)(2U * sizeof(payload[0]));

	transfer.total_size = total;
	scripted[0] = good_message(0U, 0U, total, 0U);
	scripted_result[1] = -ETIMEDOUT;
	scripted_count = 2U;

	zassert_ok(kfsw_ftp_transfer_open_sink(&transfer, TEST_SINK_PATH));
	zassert_equal(kfsw_ftp_transfer_receive(&transfer), -ETIMEDOUT,
		      "the transport error should be the one reported");
	zassert_ok(fs_close(&transfer.file));

	zassert_equal(transfer.offset, (uint32_t)sizeof(payload[0]),
		      "only the chunk that arrived should count");
	zassert_equal(__wrap_kfsw_ftp_link_release_fake.call_count, 1U,
		      "a failed receive has no frame to release");
}

ZTEST(services_ftp_transfer, test_a_replayed_chunk_is_refused)
{
	const uint32_t total = (uint32_t)(2U * sizeof(payload[0]));

	transfer.total_size = total;
	scripted[0] = good_message(0U, 0U, total, 0U);
	/* The same offset a second time, which would rewrite bytes already
	 * counted into the checksum. */
	scripted[1] = good_message(0U, 1U, total, 0U);
	scripted_count = 2U;

	zassert_ok(kfsw_ftp_transfer_open_sink(&transfer, TEST_SINK_PATH));
	zassert_equal(kfsw_ftp_transfer_receive(&transfer), -EBADMSG,
		      "a chunk that repeats an offset should be refused");
	zassert_ok(fs_close(&transfer.file));

	zassert_equal(transfer.offset, (uint32_t)sizeof(payload[0]),
		      "the refused chunk should not advance the transfer");
}

ZTEST(services_ftp_transfer, test_a_chunk_from_another_request_is_refused)
{
	const uint32_t total = (uint32_t)sizeof(payload[0]);

	transfer.total_size = total;
	scripted[0] = good_message(0U, 0U, total, 0U);
	scripted[0].request_id = TEST_REQUEST_ID + 1U;
	scripted_count = 1U;

	zassert_ok(kfsw_ftp_transfer_open_sink(&transfer, TEST_SINK_PATH));
	zassert_equal(kfsw_ftp_transfer_receive(&transfer), -EBADMSG,
		      "a chunk carrying another request id should be refused");
	zassert_ok(fs_close(&transfer.file));
	zassert_equal(transfer.offset, 0U, "nothing should be written");
}

ZTEST(services_ftp_transfer, test_a_chunk_carrying_the_wrong_opcode_is_refused)
{
	const uint32_t total = (uint32_t)sizeof(payload[0]);

	transfer.total_size = total;
	scripted[0] = good_message(0U, 0U, total, 0U);
	scripted[0].opcode = KFSW_FTP_OP_GET_DATA;
	scripted_count = 1U;

	zassert_ok(kfsw_ftp_transfer_open_sink(&transfer, TEST_SINK_PATH));
	zassert_equal(kfsw_ftp_transfer_receive(&transfer), -EBADMSG,
		      "the receive direction should not accept the other direction's data");
	zassert_ok(fs_close(&transfer.file));
}

ZTEST(services_ftp_transfer, test_a_chunk_running_past_the_agreed_size_is_refused)
{
	const uint32_t total = (uint32_t)sizeof(payload[0]);

	transfer.total_size = total;
	/* Agreed on one chunk, but two chunks of data in one message. */
	scripted[0] = good_message(0U, 0U, total, 0U);
	scripted[0].data_size = (uint16_t)(2U * sizeof(payload[0]));
	scripted_count = 1U;

	zassert_ok(kfsw_ftp_transfer_open_sink(&transfer, TEST_SINK_PATH));
	zassert_equal(kfsw_ftp_transfer_receive(&transfer), -EBADMSG,
		      "a chunk cannot be longer than what is left to receive");
	zassert_ok(fs_close(&transfer.file));
	zassert_equal(transfer.offset, 0U, "nothing should be written");
}

ZTEST(services_ftp_transfer, test_a_send_that_fails_does_not_advance_the_offset)
{
	static const uint8_t contents[16] = {0};
	struct fs_file_t file;

	fs_file_t_init(&file);
	zassert_ok(fs_open(&file, TEST_SOURCE_PATH, FS_O_CREATE | FS_O_WRITE));
	zassert_equal(fs_write(&file, contents, sizeof(contents)), (ssize_t)sizeof(contents));
	zassert_ok(fs_close(&file));

	transfer.total_size = (uint32_t)sizeof(contents);
	__wrap_kfsw_ftp_link_send_fake.return_val = -ENOTCONN;

	zassert_ok(kfsw_ftp_transfer_open_source(&transfer, TEST_SOURCE_PATH));
	zassert_equal(kfsw_ftp_transfer_send(&transfer), -ENOTCONN,
		      "the transport error should be the one reported");

	zassert_equal(__wrap_kfsw_ftp_link_send_fake.call_count, 1U,
		      "a link that refused once should not be asked again");
	zassert_equal(transfer.offset, 0U, "a chunk that was not sent should not be counted");
}

ZTEST(services_ftp_transfer, test_the_reserved_firmware_path_is_matched_by_length)
{
	static const char reserved[] = CONFIG_KFSW_FTP_FIRMWARE_PATH;
	const uint16_t size = (uint16_t)(sizeof(reserved) - 1U);
	char leading[sizeof(reserved) + 1];
	char longer[sizeof(reserved) + 8];

	leading[0] = '/';
	memcpy(&leading[1], reserved, size);
	memcpy(longer, reserved, size);
	memset(&longer[size], 'x', sizeof(longer) - size);

	zassert_true(kfsw_ftp_path_is_firmware((const uint8_t *)reserved, size));
	zassert_true(kfsw_ftp_path_is_firmware((const uint8_t *)leading, (uint16_t)(size + 1U)),
		     "a leading separator names the same file");
	zassert_false(kfsw_ftp_path_is_firmware((const uint8_t *)longer, (uint16_t)sizeof(longer)),
		      "a longer path that starts the same is a different file");
	zassert_false(kfsw_ftp_path_is_firmware((const uint8_t *)reserved, 0U));
	zassert_false(kfsw_ftp_path_is_firmware(NULL, size));
}

ZTEST(services_ftp_transfer, test_firmware_uses_peer_owner_and_preserves_normal_finish)
{
	struct kfsw_fwu_status status;
	const struct flash_area *area;
	uint8_t readback[sizeof(payload[0])];

	link_stub.peer = 16U;
	transfer.total_size = sizeof(payload[0]);
	transfer.crc32 = crc32_ieee(payload[0], sizeof(payload[0]));
	scripted[0] = good_message(0U, 0U, transfer.total_size, transfer.crc32);
	scripted_count = 1U;
	zassert_ok(kfsw_ftp_transfer_open_firmware_sink(&transfer));
	zassert_equal(transfer.firmware_handle.owner.kind, KFSW_FWU_OWNER_FTP);
	zassert_equal(transfer.firmware_handle.owner.peer, link_stub.peer);
	zassert_equal(kfsw_fwu_abort(), -EACCES);
	zassert_ok(kfsw_ftp_transfer_receive(&transfer));
	zassert_ok(kfsw_ftp_transfer_finish(&transfer, TEST_TARGET_PATH, TEST_SINK_PATH, 0));
	zassert_ok(kfsw_fwu_session_status(&transfer.firmware_handle, &status));
	zassert_equal(status.state, KFSW_FWU_READY);
	zassert_false(status.image.digest_present);
	zassert_ok(flash_area_open(DT_FIXED_PARTITION_ID(DT_CHOSEN(kfsw_fwu_partition)), &area));
	zassert_ok(flash_area_read(area, kfsw_fwu_slot_write_offset(), readback, sizeof(readback)));
	zassert_mem_equal(readback, payload[0], sizeof(readback));
	flash_area_close(area);
	zassert_ok(kfsw_fwu_session_abort(&transfer.firmware_handle, &status));
}

ZTEST(services_ftp_transfer, test_stale_firmware_cleanup_cannot_erase_successor)
{
	struct kfsw_fwu_status status;
	struct kfsw_fwu_handle next;
	const struct kfsw_fwu_owner owner = {.kind = KFSW_FWU_OWNER_FTP, .peer = 16U};
	const struct kfsw_fwu_image image = {.size = sizeof(payload[0])};

	link_stub.peer = owner.peer;
	transfer.total_size = image.size;
	zassert_ok(kfsw_ftp_transfer_open_firmware_sink(&transfer));
	zassert_ok(kfsw_fwu_session_abort(&transfer.firmware_handle, &status));
	zassert_ok(kfsw_fwu_session_begin(&owner, &image, 0U, &next, &status));
	zassert_equal(
		kfsw_ftp_transfer_finish(&transfer, TEST_TARGET_PATH, TEST_SINK_PATH, -ETIMEDOUT),
		-ETIMEDOUT);
	zassert_ok(kfsw_fwu_session_status(&next, &status));
	zassert_equal(status.state, KFSW_FWU_RECEIVING);
	zassert_ok(kfsw_fwu_session_write(&next, 0U, payload[0], sizeof(payload[0]), &status));
	zassert_ok(kfsw_fwu_session_abort(&next, &status));
}

ZTEST(services_ftp_transfer, test_busy_firmware_open_does_not_cleanup_lite_owner)
{
	const struct kfsw_fwu_owner owner = {.kind = KFSW_FWU_OWNER_LITE, .peer = 16U};
	const struct kfsw_fwu_image image = {.size = sizeof(payload[0])};
	struct kfsw_fwu_handle handle;
	struct kfsw_fwu_status status;

	zassert_ok(kfsw_fwu_session_begin(&owner, &image, 0U, &handle, &status));
	transfer.total_size = image.size;
	zassert_equal(kfsw_ftp_transfer_open_firmware_sink(&transfer), -EBUSY);
	zassert_false(transfer.firmware);
	zassert_ok(kfsw_fwu_session_status(&handle, &status));
	zassert_equal(status.state, KFSW_FWU_RECEIVING);
	zassert_false(status.aborted);
	zassert_ok(kfsw_fwu_session_abort(&handle, &status));
}

ZTEST(services_ftp_transfer, test_firmware_cleanup_errors_retain_failed_peer_and_original_error)
{
	struct kfsw_fwu_status status;

	link_stub.peer = 16U;
	transfer.total_size = sizeof(payload[0]);
	zassert_ok(kfsw_ftp_transfer_open_firmware_sink(&transfer));
	firmware_erase_error = -EIO;
	zassert_equal(
		kfsw_ftp_transfer_finish(&transfer, TEST_TARGET_PATH, TEST_SINK_PATH, -ETIMEDOUT),
		-ETIMEDOUT);
	zassert_ok(kfsw_fwu_session_status(&transfer.firmware_handle, &status));
	zassert_equal(status.state, KFSW_FWU_FAILED);
	zassert_equal(status.handle.owner.peer, link_stub.peer);
	zassert_equal(kfsw_fwu_abort(), -EACCES);
	zassert_equal(kfsw_fwu_session_abort(&transfer.firmware_handle, &status), -EIO);
	firmware_erase_error = 0;
	zassert_ok(kfsw_fwu_session_abort(&transfer.firmware_handle, &status));
}

ZTEST(services_ftp_transfer, test_failed_firmware_begin_retains_owner_if_cleanup_also_fails)
{
	struct kfsw_fwu_status status;

	link_stub.peer = 17U;
	transfer.total_size = sizeof(payload[0]);
	firmware_erase_error = -EIO;
	zassert_equal(kfsw_ftp_transfer_open_firmware_sink(&transfer), -EIO);
	zassert_ok(kfsw_fwu_get_status(&status));
	zassert_equal(status.state, KFSW_FWU_FAILED);
	zassert_equal(status.handle.owner.kind, KFSW_FWU_OWNER_FTP);
	zassert_equal(status.handle.owner.peer, link_stub.peer);
	zassert_false(status.aborted);
	zassert_equal(kfsw_fwu_abort(), -EACCES);
	firmware_erase_error = 0;
	zassert_ok(kfsw_fwu_session_abort(&status.handle, &status));
}

ZTEST(services_ftp_transfer, test_next_firmware_request_retries_saved_cleanup)
{
	struct kfsw_fwu_status status;
	struct kfsw_ftp_transfer next = {0};

	link_stub.peer = 18U;
	transfer.total_size = sizeof(payload[0]);
	zassert_ok(kfsw_ftp_transfer_open_firmware_sink(&transfer));
	firmware_erase_error = -EIO;
	zassert_equal(
		kfsw_ftp_transfer_finish(&transfer, TEST_TARGET_PATH, TEST_SINK_PATH, -ETIMEDOUT),
		-ETIMEDOUT);
	firmware_erase_error = 0;
	next.link = &link_stub;
	next.total_size = sizeof(payload[0]);
	zassert_ok(kfsw_ftp_transfer_open_firmware_sink(&next));
	zassert_not_equal(next.firmware_handle.generation, transfer.firmware_handle.generation);
	zassert_ok(kfsw_fwu_session_abort(&next.firmware_handle, &status));
}

ZTEST(services_ftp_transfer, test_failed_open_cleanup_retry_survives_old_context)
{
	struct kfsw_fwu_status status;
	struct kfsw_ftp_transfer next = {0};

	link_stub.peer = 19U;
	transfer.total_size = sizeof(payload[0]);
	firmware_erase_error = -EIO;
	zassert_equal(kfsw_ftp_transfer_open_firmware_sink(&transfer), -EIO);
	next.link = &link_stub;
	next.total_size = sizeof(payload[0]);
	zassert_equal(kfsw_ftp_transfer_open_firmware_sink(&next), -EIO);
	firmware_erase_error = 0;
	zassert_ok(kfsw_ftp_transfer_open_firmware_sink(&next));
	zassert_ok(kfsw_fwu_session_abort(&next.firmware_handle, &status));
}

ZTEST(services_ftp_transfer, test_cached_cleanup_cannot_adopt_successor)
{
	const struct kfsw_fwu_owner owner = {.kind = KFSW_FWU_OWNER_FTP, .peer = 20U};
	const struct kfsw_fwu_image image = {.size = sizeof(payload[0])};
	struct kfsw_fwu_handle successor;
	struct kfsw_fwu_status status;
	struct kfsw_ftp_transfer next = {0};

	link_stub.peer = owner.peer;
	transfer.total_size = image.size;
	zassert_ok(kfsw_ftp_transfer_open_firmware_sink(&transfer));
	firmware_erase_error = -EIO;
	zassert_equal(
		kfsw_ftp_transfer_finish(&transfer, TEST_TARGET_PATH, TEST_SINK_PATH, -ETIMEDOUT),
		-ETIMEDOUT);
	firmware_erase_error = 0;
	zassert_ok(kfsw_fwu_session_abort(&transfer.firmware_handle, &status));
	zassert_ok(kfsw_fwu_session_begin(&owner, &image, 0U, &successor, &status));
	next.link = &link_stub;
	next.total_size = image.size;
	zassert_equal(kfsw_ftp_transfer_open_firmware_sink(&next), -EBUSY);
	zassert_ok(kfsw_fwu_session_status(&successor, &status));
	zassert_equal(status.state, KFSW_FWU_RECEIVING);
	zassert_false(status.aborted);
	zassert_ok(kfsw_fwu_session_abort(&successor, &status));
}
```
