## tests/unit/services_command_retry/testcase.yaml
```yaml
tests:
  kfsw.services.command_retry:
    tags:
      - unit
      - services
      - command
    platform_allow:
      - native_sim/native/64
    integration_platforms:
      - native_sim/native/64
```

## tests/unit/services_event/testcase.yaml
```yaml
tests:
  kfsw.services.event:
    tags:
      - unit
      - services
      - event
    platform_allow:
      - native_sim/native/64
    integration_platforms:
      - native_sim/native/64
```

## tests/unit/services_fbo/testcase.yaml
```yaml
tests:
  kfsw.services.fbo:
    tags: [unit, services, fbo]
    platform_allow: [native_sim/native/64]
    integration_platforms: [native_sim/native/64]
```

## tests/unit/services_fbo_schedule/testcase.yaml
```yaml
tests:
  kfsw.services.fbo.schedule:
    tags: [unit, services, fbo]
    platform_allow: [native_sim/native/64]
    integration_platforms: [native_sim/native/64]
```

## tests/unit/services_ftp/testcase.yaml
```yaml
tests:
  kfsw.services.ftp:
    tags:
      - unit
      - services
      - ftp
      - storage
      - csp
    platform_allow:
      - native_sim/native/64
    integration_platforms:
      - native_sim/native/64
```

## tests/unit/services_ftp_client/testcase.yaml
```yaml
---
tests:
  kfsw.services.ftp_client:
    tags:
      - unit
      - services
      - ftp
    platform_allow:
      - native_sim/native/64
    integration_platforms:
      - native_sim/native/64
```

## tests/unit/services_ftp_client_link/testcase.yaml
```yaml
---
tests:
  kfsw.services.ftp.client_link:
    tags:
      - unit
      - services
      - ftp
      - littlefs
    platform_allow:
      - native_sim/native/64
    integration_platforms:
      - native_sim/native/64
  kfsw.services.ftp.client_link.csp1:
    tags:
      - unit
      - services
      - ftp
      - littlefs
    platform_allow:
      - native_sim/native/64
    integration_platforms:
      - native_sim/native/64
    extra_configs:
      - CONFIG_KFSW_CSP_VERSION_1=y
```

## tests/unit/services_ftp_server/testcase.yaml
```yaml
---
tests:
  kfsw.services.ftp.server:
    tags:
      - unit
      - services
      - ftp
      - littlefs
    platform_allow:
      - native_sim/native/64
    integration_platforms:
      - native_sim/native/64
```

## tests/unit/services_fwu/testcase.yaml
```yaml
tests:
  kfsw.services.fwu:
    tags:
      - unit
      - services
      - fwu
    platform_allow:
      - native_sim/native/64
    integration_platforms:
      - native_sim/native/64
```

## tests/unit/services_fwu_files/testcase.yaml
```yaml
tests:
  kfsw.services.fwu_files:
    tags: [unit, services, fwu, filesystem]
    platform_allow: [native_sim/native/64]
    integration_platforms: [native_sim/native/64]
```

## tests/unit/services_fwu_lite/testcase.yaml
```yaml
tests:
  kfsw.services.fwu_lite:
    tags:
      - unit
      - services
      - fwu
    platform_allow:
      - native_sim/native/64
    integration_platforms:
      - native_sim/native/64
  kfsw.services.fwu_lite.recovery:
    tags: [unit, services, fwu]
    platform_allow: [native_sim/native/64]
    extra_args:
      - DTC_OVERLAY_FILE="app.overlay;recovery.overlay"
    extra_configs:
      - CONFIG_KFSW_FWU_RECOVERY=y
      - CONFIG_KFSW_FWU_SLOT_OFFSET_SECTORS=0
```

## tests/unit/services_fwu_lite_client/testcase.yaml
```yaml
tests:
  kfsw.services.fwu_lite_client:
    tags: [unit, services, fwu]
    platform_allow: [native_sim/native/64]
    integration_platforms: [native_sim/native/64]
  kfsw.services.fwu_lite_client.small_buffer:
    tags: [unit, services, fwu]
    platform_allow: [native_sim/native/64]
    extra_configs:
      - CONFIG_KFSW_FWU_STREAM_BUFFER_SIZE=64
  kfsw.services.fwu_lite_client.rdp:
    tags: [unit, services, fwu]
    platform_allow: [native_sim/native/64]
    extra_configs:
      - CONFIG_KFSW_FWU_LITE_RDP=y
```

## tests/unit/services_fwu_lite_start/testcase.yaml
```yaml
tests:
  kfsw.services.fwu_lite_start:
    tags: [unit, services, fwu]
    platform_allow: [native_sim/native/64]
    integration_platforms: [native_sim/native/64]
```

## tests/unit/services_gndwdt/testcase.yaml
```yaml
---
tests:
  kfsw.services.gndwdt:
    tags:
      - unit
      - services
      - gndwdt
    platform_allow:
      - native_sim/native
      - native_sim/native/64
    integration_platforms:
      - native_sim/native
      - native_sim/native/64
  kfsw.services.gndwdt.parameters:
    tags: [unit, services, gndwdt]
    extra_configs:
      - CONFIG_KFSW_PARAM=y
    platform_allow:
      - native_sim/native
      - native_sim/native/64
    integration_platforms:
      - native_sim/native
      - native_sim/native/64
  kfsw.services.gndwdt.events:
    tags: [unit, services, gndwdt]
    extra_configs:
      - CONFIG_KFSW_PARAM=y
      - CONFIG_KFSW_EVENT=y
    platform_allow:
      - native_sim/native
      - native_sim/native/64
    integration_platforms:
      - native_sim/native
      - native_sim/native/64
```

## tests/unit/services_health/testcase.yaml
```yaml
tests:
  kfsw.services.health:
    tags:
      - unit
      - services
      - health
    platform_allow:
      - native_sim/native/64
    integration_platforms:
      - native_sim/native/64
  kfsw.services.health.parameters:
    tags: [unit, services, health]
    extra_configs:
      - CONFIG_KFSW_PARAM=y
      - CONFIG_KFSW_HEALTH_SLOTS=y
      - CONFIG_KFSW_HEALTH_SLOTS_HEADER="health_test_slots.h"
    platform_allow:
      - native_sim/native/64
    integration_platforms:
      - native_sim/native/64
```

## tests/unit/services_hk/testcase.yaml
```yaml
---
tests:
  kfsw.services.hk:
    tags:
      - unit
      - services
      - hk
    platform_allow:
      - native_sim/native/64
    integration_platforms:
      - native_sim/native/64
```

## tests/unit/services_hk_beacon/testcase.yaml
```yaml
---
tests:
  kfsw.services.hk.beacon:
    tags:
      - unit
      - services
      - hk
    platform_allow:
      - native_sim/native/64
    integration_platforms:
      - native_sim/native/64
  kfsw.services.hk.beacon.csp1:
    tags:
      - unit
      - services
      - hk
    platform_allow:
      - native_sim/native/64
    integration_platforms:
      - native_sim/native/64
    extra_configs:
      - CONFIG_KFSW_CSP_VERSION_1=y
```

## tests/unit/services_hk_collector/testcase.yaml
```yaml
---
tests:
  kfsw.services.hk.collector:
    tags:
      - unit
      - services
      - hk
    platform_allow:
      - native_sim/native/64
    integration_platforms:
      - native_sim/native/64
```

## tests/unit/services_hk_persistence/testcase.yaml
```yaml
---
tests:
  kfsw.services.hk.persistence:
    tags:
      - unit
      - services
      - hk
      - littlefs
    platform_allow:
      - native_sim/native/64
    integration_platforms:
      - native_sim/native/64
```

## tests/unit/services_hk_remote/testcase.yaml
```yaml
---
tests:
  kfsw.services.hk_remote:
    tags:
      - unit
      - services
      - hk
      - csp
    platform_allow:
      - native_sim/native/64
    integration_platforms:
      - native_sim/native/64
```

## tests/unit/services_hk_server/testcase.yaml
```yaml
---
tests:
  kfsw.services.hk.server:
    tags:
      - unit
      - services
      - hk
    platform_allow:
      - native_sim/native/64
    integration_platforms:
      - native_sim/native/64
```

## tests/unit/services_limits/testcase.yaml
```yaml
tests:
  kfsw.services.limits:
    tags: [unit, services, limits]
    platform_allow: [native_sim/native/64]
    integration_platforms: [native_sim/native/64]
```

## tests/unit/services_limits_remote/testcase.yaml
```yaml
tests:
  kfsw.services.limits_remote:
    tags: [unit, services, limits, csp]
    platform_allow: [native_sim/native/64]
    integration_platforms: [native_sim/native/64]
```

## tests/unit/services_log_history/testcase.yaml
```yaml
common:
  tags: [unit, services, log]
  platform_allow: [native_sim/native/64]
  integration_platforms: [native_sim/native/64]
tests:
  kfsw.services.log_history: {}
  kfsw.services.log_history.local:
    extra_configs:
      - CONFIG_KFSW_LOG_REMOTE=n
  kfsw.services.log_history.volatile:
    extra_configs:
      - CONFIG_KFSW_LOG_HISTORY_RETAINED=n
```

## tests/unit/services_log_semihost/testcase.yaml
```yaml
common:
  tags: [unit, services, log, platform]
  platform_allow: [native_sim/native/64]
  integration_platforms: [native_sim/native/64]
tests:
  kfsw.services.log_semihost: {}
  kfsw.services.log_semihost.color:
    extra_configs:
      - CONFIG_KFSW_LOG_COLOR=y
```
