## CMakeLists.txt
```
cmake_minimum_required(VERSION 3.20.0)

get_filename_component(KFSW_WORKSPACE_ROOT
    "${CMAKE_CURRENT_LIST_DIR}/../../../.."
    ABSOLUTE
)

list(APPEND ZEPHYR_EXTRA_MODULES
    "${KFSW_WORKSPACE_ROOT}/kfsw-platform"
    "${KFSW_WORKSPACE_ROOT}/kfsw-comms/third_party/libcsp"
    "${KFSW_WORKSPACE_ROOT}/kfsw-comms"
    "${KFSW_WORKSPACE_ROOT}/kfsw-services"
)

set(CSP_REPRODUCIBLE_BUILDS ON CACHE BOOL "" FORCE)
set(CSP_USE_RDP ON CACHE BOOL "" FORCE)
set(CSP_USE_HMAC OFF CACHE BOOL "" FORCE)
set(CSP_USE_PROMISC OFF CACHE BOOL "" FORCE)

find_package(Zephyr REQUIRED HINTS $ENV{ZEPHYR_BASE})
project(kfsw_services_ftp_tests LANGUAGES C)

target_sources(app PRIVATE src/main.c)
target_include_directories(app PRIVATE "${KFSW_WORKSPACE_ROOT}/kfsw-services/src/ftp")
target_link_libraries(app PRIVATE kfsw::services kfsw::comms)
```

## prj.conf
```kconfig
CONFIG_ZTEST=y

CONFIG_FLASH=y
CONFIG_FLASH_MAP=y
CONFIG_FILE_SYSTEM=y
CONFIG_FILE_SYSTEM_LITTLEFS=y
CONFIG_FILE_SYSTEM_MKFS=y
CONFIG_KFSW_STORAGE=y

CONFIG_KFSW_CSP=y
CONFIG_KFSW_CSP_ADDRESS=7
CONFIG_KFSW_CSP_HOSTNAME="kfsw-ftp-test"
CONFIG_KFSW_CSP_KISS_UART=n
CONFIG_KFSW_FTP=y
CONFIG_KFSW_FTP_TIMEOUT_MS=1000

# The update service is enabled to test the reserved upload path in the
# transfer layer.
CONFIG_KFSW_FWU=y
CONFIG_KFSW_FWU_MCUBOOT=n

CONFIG_DISK_ACCESS=y
CONFIG_FS_LITTLEFS_BLK_DEV=y
```

## boards/native_sim_native_64.overlay
```dts
/ {
	chosen {
		kfsw,fwu-partition = &slot1_partition;
		kfsw,storage-partition = &storage_partition;
		kfsw,tmp-disk = &tmp_disk;
	};

	/* RAM volume behind /kfsw/tmp. */
	tmp_disk: tmp-disk {
		compatible = "zephyr,ram-disk";
		disk-name = "TMP";
		sector-size = <512>;
		sector-count = <64>;
	};
};

&storage_partition {
	label = "kfsw-ftp-test";
	reg = <0x000fc000 0x00010000>;
};
```

## src/main.c
```c
#include <errno.h>
#include <stdbool.h>
#include <stdint.h>
#include <string.h>

#include <zephyr/fs/fs.h>
#include <zephyr/storage/flash_map.h>
#include <zephyr/sys/byteorder.h>
#include <zephyr/ztest.h>

#include <kfsw/comms/csp.h>
#include <kfsw/platform/storage.h>
#include <kfsw/services/ftp.h>

#include "ftp_internal.h"

#define STORAGE_PARTITION_NODE DT_CHOSEN(kfsw_storage_partition)
#define TEST_FINAL_PATH KFSW_FTP_STORAGE_ROOT "/build/atomic.bin"
#define TEST_TEMP_PATH TEST_FINAL_PATH ".part"

static void erase_storage_partition(void)
{
	const struct flash_area *area;

	zassert_ok(flash_area_open(DT_FIXED_PARTITION_ID(STORAGE_PARTITION_NODE), &area));
	zassert_ok(flash_area_flatten(area, 0, area->fa_size));
	flash_area_close(area);
}

static void write_file(const char *path, const uint8_t *data, size_t size)
{
	struct fs_file_t file;

	fs_file_t_init(&file);
	zassert_ok(fs_open(&file, path, FS_O_CREATE | FS_O_WRITE | FS_O_TRUNC));
	zassert_equal(fs_write(&file, data, size), (ssize_t)size);
	zassert_ok(fs_sync(&file));
	zassert_ok(fs_close(&file));
}

static void assert_file(const char *path, const uint8_t *expected, size_t expected_size)
{
	struct fs_file_t file;
	uint8_t actual[32];
	ssize_t size;

	zassert_true(expected_size <= sizeof(actual));
	fs_file_t_init(&file);
	zassert_ok(fs_open(&file, path, FS_O_READ));
	size = fs_read(&file, actual, sizeof(actual));
	zassert_equal(size, (ssize_t)expected_size);
	zassert_mem_equal(actual, expected, expected_size);
	zassert_ok(fs_close(&file));
}

static void *ftp_setup(void)
{
	erase_storage_partition();
	zassert_ok(kfsw_storage_init());
	zassert_ok(kfsw_storage_mount());
	zassert_ok(kfsw_storage_tmp_mount());
	zassert_ok(kfsw_ftp_init());
	zassert_ok(kfsw_csp_init());
	zassert_ok(kfsw_csp_start());
	zassert_ok(kfsw_ftp_start());
	return NULL;
}

ZTEST(services_ftp, test_path_validation_and_resolution)
{
	char resolved[KFSW_FTP_FULL_PATH_SIZE];
	char overlong[KFSW_FTP_MAX_PATH_SIZE + 2U];

	zassert_ok(kfsw_ftp_validate_path("telemetry.bin", false));
	zassert_ok(kfsw_ftp_validate_path("/flash/sample.txt", false));
	zassert_ok(kfsw_ftp_validate_path("", true));
	zassert_ok(kfsw_ftp_resolve_path("/flash/sample.txt", false, resolved, sizeof(resolved)));
	zassert_equal(strcmp(resolved, KFSW_FTP_STORAGE_ROOT "/flash/sample.txt"), 0);

	zassert_equal(kfsw_ftp_validate_path("", false), -EINVAL);
	zassert_equal(kfsw_ftp_validate_path("/", false), -EINVAL);
	zassert_equal(kfsw_ftp_validate_path("../params/parameters.dat", false), -EINVAL);
	zassert_equal(kfsw_ftp_validate_path("a/../b", false), -EINVAL);
	zassert_equal(kfsw_ftp_validate_path("a/./b", false), -EINVAL);
	zassert_equal(kfsw_ftp_validate_path("a//b", false), -EINVAL);
	zassert_equal(kfsw_ftp_validate_path("a/", false), -EINVAL);
	zassert_equal(kfsw_ftp_validate_path("a\\b", false), -EINVAL);
	zassert_equal(kfsw_ftp_validate_path("a\x1f"
					     "b",
					     false),
		      -EINVAL);

	memset(overlong, 'a', sizeof(overlong));
	overlong[sizeof(overlong) - 1U] = '\0';
	zassert_equal(kfsw_ftp_validate_path(overlong, false), -ENAMETOOLONG);
}

ZTEST(services_ftp, test_protocol_round_trip_and_portable_encoding)
{
	static const uint8_t data[] = {0x11, 0x22, 0x33};
	const struct kfsw_ftp_message message = {
		.opcode = KFSW_FTP_OP_PUT_DATA,
		.request_id = 0x12345678U,
		.offset = 0x01020304U,
		.total_size = 0x11223344U,
		.crc32 = 0xaabbccddU,
		.data_size = sizeof(data),
		.data = data,
	};
	struct kfsw_ftp_message decoded;
	uint8_t encoded[64];
	size_t encoded_size;

	zassert_ok(kfsw_ftp_protocol_encode(encoded, sizeof(encoded), &message, &encoded_size));
	zassert_equal(encoded_size, KFSW_FTP_PROTOCOL_HEADER_SIZE + sizeof(data));
	zassert_equal(encoded[0], KFSW_FTP_PROTOCOL_VERSION);
	zassert_equal(encoded[1], KFSW_FTP_OP_PUT_DATA);
	zassert_equal(sys_get_be32(&encoded[4]), message.request_id);
	zassert_equal(sys_get_be32(&encoded[8]), message.offset);
	zassert_equal(sys_get_be32(&encoded[12]), message.total_size);
	zassert_equal(sys_get_be32(&encoded[16]), message.crc32);
	zassert_equal(sys_get_be16(&encoded[22]), sizeof(data));

	zassert_ok(kfsw_ftp_protocol_decode(encoded, encoded_size, &decoded));
	zassert_equal(decoded.opcode, message.opcode);
	zassert_equal(decoded.request_id, message.request_id);
	zassert_equal(decoded.offset, message.offset);
	zassert_equal(decoded.total_size, message.total_size);
	zassert_equal(decoded.crc32, message.crc32);
	zassert_equal(decoded.data_size, sizeof(data));
	zassert_mem_equal(decoded.data, data, sizeof(data));
}

ZTEST(services_ftp, test_read_only_status_survives_the_wire)
{
	zassert_equal(kfsw_ftp_errno_to_wire_status(-EROFS), KFSW_FTP_STATUS_READ_ONLY);
	zassert_equal(kfsw_ftp_wire_status_to_errno(KFSW_FTP_STATUS_READ_ONLY), -EROFS);
	zassert_equal(kfsw_ftp_wire_status_to_errno(KFSW_FTP_STATUS_IO_ERROR), -EIO);
	zassert_equal(kfsw_ftp_wire_status_to_errno(UINT8_MAX), -EIO);
}

ZTEST(services_ftp, test_remove_opcodes_round_trip)
{
	struct kfsw_ftp_message message = {.opcode = KFSW_FTP_OP_REMOVE_REQUEST};
	struct kfsw_ftp_message decoded;
	uint8_t encoded[KFSW_FTP_PROTOCOL_HEADER_SIZE];
	size_t size;

	zassert_equal(KFSW_FTP_OP_GET_RESULT, 15U);
	zassert_equal(KFSW_FTP_OP_REMOVE_REQUEST, 16U);
	zassert_equal(KFSW_FTP_OP_REMOVE_RESPONSE, 17U);
	for (uint8_t opcode = KFSW_FTP_OP_REMOVE_REQUEST; opcode <= KFSW_FTP_OP_REMOVE_RESPONSE;
	     opcode++) {
		message.opcode = opcode;
		zassert_ok(kfsw_ftp_protocol_encode(encoded, sizeof(encoded), &message, &size));
		zassert_ok(kfsw_ftp_protocol_decode(encoded, size, &decoded));
		zassert_equal(decoded.opcode, opcode);
	}
	message.opcode = KFSW_FTP_OP_REMOVE_RESPONSE + 1U;
	zassert_equal(kfsw_ftp_protocol_encode(encoded, sizeof(encoded), &message, &size), -EINVAL);
	encoded[1] = message.opcode;
	zassert_equal(kfsw_ftp_protocol_decode(encoded, sizeof(encoded), &decoded), -ENOTSUP);
}

ZTEST(services_ftp, test_boot_paths_select_the_read_only_slot_mount)
{
	char resolved[KFSW_FTP_FULL_PATH_SIZE];

	zassert_ok(
		kfsw_ftp_resolve_path("/boot/firmware_1.bin", false, resolved, sizeof(resolved)));
	zassert_str_equal(resolved, "/kfsw/boot/firmware_1.bin");
	zassert_ok(kfsw_ftp_resolve_path("boot", true, resolved, sizeof(resolved)));
	zassert_str_equal(resolved, "/kfsw/boot");
	zassert_equal(
		kfsw_ftp_resolve_write_path("boot/firmware_2.bin", resolved, sizeof(resolved)),
		-EROFS);
	zassert_equal(kfsw_ftp_resolve_path("/boot/../params", false, resolved, sizeof(resolved)),
		      -EINVAL);
	zassert_ok(kfsw_ftp_resolve_write_path("bootlog", resolved, sizeof(resolved)));
	zassert_str_equal(resolved, KFSW_FTP_STORAGE_ROOT "/bootlog");
	zassert_ok(kfsw_ftp_resolve_path("/hk/0.bin", false, resolved, sizeof(resolved)));
	zassert_str_equal(resolved, KFSW_FTP_READONLY_ROOT "/0.bin");
}

ZTEST(services_ftp, test_malformed_protocol_is_rejected)
{
	uint8_t encoded[KFSW_FTP_PROTOCOL_HEADER_SIZE + 2U] = {0};
	struct kfsw_ftp_message decoded;

	encoded[0] = KFSW_FTP_PROTOCOL_VERSION;
	encoded[1] = KFSW_FTP_OP_LIST_REQUEST;
	zassert_equal(kfsw_ftp_protocol_decode(encoded, sizeof(encoded), &decoded), -EMSGSIZE);

	zassert_equal(
		kfsw_ftp_protocol_decode(encoded, KFSW_FTP_PROTOCOL_HEADER_SIZE - 1U, &decoded),
		-EMSGSIZE);
	encoded[0] = KFSW_FTP_PROTOCOL_VERSION + 1U;
	zassert_equal(kfsw_ftp_protocol_decode(encoded, KFSW_FTP_PROTOCOL_HEADER_SIZE, &decoded),
		      -EPROTONOSUPPORT);
	encoded[0] = KFSW_FTP_PROTOCOL_VERSION;
	sys_put_be16(KFSW_FTP_MAX_PATH_SIZE + 1U, &encoded[20]);
	zassert_equal(kfsw_ftp_protocol_decode(encoded, KFSW_FTP_PROTOCOL_HEADER_SIZE, &decoded),
		      -EMSGSIZE);
	sys_put_be16(2U, &encoded[20]);
	encoded[KFSW_FTP_PROTOCOL_HEADER_SIZE] = 'a';
	encoded[KFSW_FTP_PROTOCOL_HEADER_SIZE + 1U] = '\0';
	zassert_equal(kfsw_ftp_protocol_decode(encoded, sizeof(encoded), &decoded), -EBADMSG);
}

ZTEST(services_ftp, test_file_crc_and_missing_file)
{
	static const uint8_t contents[] = "123456789";
	struct kfsw_ftp_workspace workspace;
	uint32_t file_size;
	uint32_t crc32;

	write_file(KFSW_FTP_STORAGE_ROOT "/build/crc.bin", contents, sizeof(contents) - 1U);
	zassert_ok(kfsw_ftp_file_crc(KFSW_FTP_STORAGE_ROOT "/build/crc.bin", &workspace, &file_size,
				     &crc32));
	zassert_equal(file_size, sizeof(contents) - 1U);
	zassert_equal(crc32, 0xcbf43926U);
	zassert_equal(kfsw_ftp_file_crc(KFSW_FTP_STORAGE_ROOT "/build/missing.bin", &workspace,
					&file_size, &crc32),
		      -ENOENT);
}

ZTEST(services_ftp, test_failed_commit_preserves_existing_file)
{
	static const uint8_t original[] = "known-good";
	static const uint8_t partial[] = "incomplete";
	struct fs_dirent entry;

	write_file(TEST_FINAL_PATH, original, sizeof(original) - 1U);
	write_file(TEST_TEMP_PATH, partial, sizeof(partial) - 1U);
	zassert_equal(kfsw_ftp_commit_temporary(TEST_FINAL_PATH, TEST_TEMP_PATH,
						sizeof(partial) - 1U, 0x12345678U, sizeof(partial),
						0x12345678U),
		      -EILSEQ);
	assert_file(TEST_FINAL_PATH, original, sizeof(original) - 1U);
	zassert_equal(fs_stat(TEST_TEMP_PATH, &entry), -ENOENT);
}

ZTEST(services_ftp, test_successful_commit_atomically_replaces_file)
{
	static const uint8_t original[] = "old";
	static const uint8_t replacement[] = "complete replacement";
	struct fs_dirent entry;

	write_file(TEST_FINAL_PATH, original, sizeof(original) - 1U);
	write_file(TEST_TEMP_PATH, replacement, sizeof(replacement) - 1U);
	zassert_ok(kfsw_ftp_commit_temporary(TEST_FINAL_PATH, TEST_TEMP_PATH,
					     sizeof(replacement) - 1U, 0x89abcdefU,
					     sizeof(replacement) - 1U, 0x89abcdefU));
	assert_file(TEST_FINAL_PATH, replacement, sizeof(replacement) - 1U);
	zassert_equal(fs_stat(TEST_TEMP_PATH, &entry), -ENOENT);
}

struct local_list_result {
	uint32_t entries;
	bool found_file;
	uint32_t file_size;
};

static bool collect_local_entry(const struct kfsw_ftp_entry *entry, void *context)
{
	struct local_list_result *result = context;

	result->entries++;
	if (strcmp(entry->name, "local.bin") == 0) {
		result->found_file = entry->type == KFSW_FTP_ENTRY_FILE;
		result->file_size = entry->size;
	}
	return true;
}

static uint16_t local_node(void)
{
	struct kfsw_csp_info csp_info;

	kfsw_csp_get_info(&csp_info);
	return csp_info.address;
}

ZTEST(services_ftp, test_local_remove_file_and_empty_directory)
{
	static const uint8_t contents[] = "remove me";
	const uint16_t node = local_node();
	struct fs_dirent entry;
	struct kfsw_ftp_stats before;
	struct kfsw_ftp_stats after;

	zassert_ok(kfsw_ftp_get_stats(&before));
	zassert_ok(kfsw_ftp_mkdir(node, "/remove-empty"));
	write_file(KFSW_FTP_STORAGE_ROOT "/remove-empty/file", contents, sizeof(contents));
	zassert_ok(kfsw_ftp_remove(node, "/remove-empty/file"));
	zassert_equal(fs_stat(KFSW_FTP_STORAGE_ROOT "/remove-empty/file", &entry), -ENOENT);
	zassert_ok(kfsw_ftp_remove(node, "/remove-empty"));
	zassert_equal(fs_stat(KFSW_FTP_STORAGE_ROOT "/remove-empty", &entry), -ENOENT);
	zassert_ok(kfsw_ftp_get_stats(&after));
	zassert_equal(after.transfers, before.transfers);
	zassert_equal(after.failures, before.failures);
	zassert_equal(after.bytes, before.bytes);
}

ZTEST(services_ftp, test_local_remove_refuses_nonempty_directory)
{
	static const uint8_t contents[] = "keep me";
	const uint16_t node = local_node();
	struct fs_dirent entry;

	zassert_ok(kfsw_ftp_mkdir(node, "/remove-full"));
	write_file(KFSW_FTP_STORAGE_ROOT "/remove-full/file", contents, sizeof(contents));
	zassert_equal(kfsw_ftp_remove(node, "/remove-full"), -ENOTEMPTY);
	zassert_ok(fs_stat(KFSW_FTP_STORAGE_ROOT "/remove-full", &entry));
	assert_file(KFSW_FTP_STORAGE_ROOT "/remove-full/file", contents, sizeof(contents));
}

ZTEST(services_ftp, test_local_remove_protects_readonly_paths_and_roots)
{
	static const uint8_t contents[] = "housekeeping";
	const uint16_t node = local_node();
	struct fs_dirent entry;
	int result = fs_mkdir(KFSW_FTP_READONLY_ROOT);

	zassert_true((result == 0) || (result == -EEXIST));
	write_file(KFSW_FTP_READONLY_ROOT "/remove.bin", contents, sizeof(contents));
	zassert_equal(kfsw_ftp_remove(node, "/hk/remove.bin"), -EROFS);
	zassert_equal(kfsw_ftp_remove(node, "hk/remove.bin"), -EROFS);
	zassert_equal(kfsw_ftp_remove(node, "/hk"), -EROFS);
	zassert_equal(kfsw_ftp_remove(node, "/boot/file"), -EROFS);
	assert_file(KFSW_FTP_READONLY_ROOT "/remove.bin", contents, sizeof(contents));
	zassert_equal(kfsw_ftp_remove(node, NULL), -EINVAL);
	zassert_equal(kfsw_ftp_remove(node, ""), -EINVAL);
	zassert_equal(kfsw_ftp_remove(node, "/"), -EINVAL);
	zassert_equal(kfsw_ftp_remove(node, "/tmp"), -EINVAL);
	zassert_equal(kfsw_ftp_remove(node, "a/../b"), -EINVAL);
	zassert_ok(fs_stat(KFSW_FTP_STORAGE_ROOT, &entry));
	zassert_equal(entry.type, FS_DIR_ENTRY_DIR);
	zassert_ok(fs_stat(KFSW_STORAGE_TMP_MOUNT_POINT, &entry));
	zassert_equal(entry.type, FS_DIR_ENTRY_DIR);
}

ZTEST(services_ftp, test_local_remove_missing_path)
{
	zassert_equal(kfsw_ftp_remove(local_node(), "/remove-missing"), -ENOENT);
}

ZTEST(services_ftp, test_local_remove_recovers_free_bytes)
{
	static const uint8_t contents[16384] = {0x5a};
	struct kfsw_storage_info before;
	struct kfsw_storage_info written;
	struct kfsw_storage_info removed;

	zassert_ok(kfsw_storage_get_info(&before));
	write_file(KFSW_FTP_STORAGE_ROOT "/remove-space", contents, sizeof(contents));
	zassert_ok(kfsw_storage_get_info(&written));
	zassert_true(written.free_bytes < before.free_bytes);
	zassert_ok(kfsw_ftp_remove(local_node(), "/remove-space"));
	zassert_ok(kfsw_storage_get_info(&removed));
	zassert_true(removed.free_bytes >= written.free_bytes + sizeof(contents));
	printk("Local remove recovered %llu free bytes\n",
	       (unsigned long long)(removed.free_bytes - written.free_bytes));
}

ZTEST(services_ftp, test_local_remove_from_tmp)
{
	static const uint8_t contents[] = "scratch";
	struct fs_dirent entry;

	write_file(KFSW_STORAGE_TMP_MOUNT_POINT "/remove.bin", contents, sizeof(contents));
	zassert_ok(kfsw_ftp_remove(local_node(), "/tmp/remove.bin"));
	zassert_equal(fs_stat(KFSW_STORAGE_TMP_MOUNT_POINT "/remove.bin", &entry), -ENOENT);
}

ZTEST(services_ftp, test_local_node_requests_bypass_csp)
{
	static const uint8_t contents[] = "123456789";
	const uint16_t node = local_node();
	struct local_list_result listed = {0};
	struct kfsw_ftp_stat info;

	/* No route or peer exists for this address; the service must not need one. */
	zassert_ok(kfsw_ftp_mkdir(node, "/local"));
	zassert_equal(kfsw_ftp_mkdir(node, "/local"), -EEXIST);

	write_file(KFSW_FTP_STORAGE_ROOT "/local/local.bin", contents, sizeof(contents) - 1U);
	zassert_ok(kfsw_ftp_list(node, "/local", collect_local_entry, &listed));
	zassert_equal(listed.entries, 1U);
	zassert_true(listed.found_file);
	zassert_equal(listed.file_size, sizeof(contents) - 1U);

	zassert_ok(kfsw_ftp_stat(node, "/local/local.bin", &info));
	zassert_equal(info.type, KFSW_FTP_ENTRY_FILE);
	zassert_equal(info.size, sizeof(contents) - 1U);
	zassert_equal(info.crc32, 0xcbf43926U);

	zassert_ok(kfsw_ftp_stat(node, "", &info));
	zassert_equal(info.type, KFSW_FTP_ENTRY_DIRECTORY);
}

ZTEST(services_ftp, test_local_node_negative_paths)
{
	const uint16_t node = local_node();
	struct kfsw_ftp_transfer_result transfer;
	struct local_list_result listed = {0};
	struct kfsw_ftp_stat info;

	zassert_equal(kfsw_ftp_list(node, "/missing", collect_local_entry, &listed), -ENOENT);
	zassert_equal(listed.entries, 0U);
	zassert_equal(kfsw_ftp_stat(node, "/missing.bin", &info), -ENOENT);
	zassert_equal(kfsw_ftp_mkdir(node, "../params/parameters.dat"), -EINVAL);
	zassert_equal(kfsw_ftp_mkdir(node, ""), -EINVAL);

	/* A transfer needs two nodes; the local address must fail explicitly. */
	zassert_equal(kfsw_ftp_put(node, "/local/local.bin", "/local/copy.bin", &transfer),
		      -ENOTSUP);
	zassert_equal(kfsw_ftp_get(node, "/local/local.bin", "/local/copy.bin", &transfer),
		      -ENOTSUP);
}

static bool find_read_only_root(const struct kfsw_ftp_entry *entry, void *context)
{
	bool *found = context;

	if ((strcmp(entry->name, KFSW_FTP_HK_PATH) == 0) &&
	    (entry->type == KFSW_FTP_ENTRY_DIRECTORY)) {
		*found = true;
	}
	return true;
}

ZTEST(services_ftp, test_root_listing_shows_read_only_roots)
{
	const uint16_t node = local_node();
	bool found = false;
	int result;

	result = fs_mkdir(KFSW_FTP_READONLY_ROOT);
	zassert_true((result == 0) || (result == -EEXIST));

	zassert_ok(kfsw_ftp_list(node, "/", find_read_only_root, &found));
	zassert_true(found);

	/* Only the root shows them. */
	found = false;
	zassert_ok(kfsw_ftp_mkdir(node, "/elsewhere"));
	zassert_ok(kfsw_ftp_list(node, "/elsewhere", find_read_only_root, &found));
	zassert_false(found);
}

static bool find_tmp_root(const struct kfsw_ftp_entry *entry, void *context)
{
	bool *found = context;

	if (strcmp(entry->name, KFSW_FTP_TMP_PATH) == 0) {
		*found = true;
	}
	return true;
}

ZTEST(services_ftp, test_tmp_root_is_writable)
{
	const uint16_t node = local_node();
	struct kfsw_ftp_stat info;
	bool found = false;

	zassert_ok(kfsw_ftp_list(node, "/", find_tmp_root, &found));
	zassert_true(found);
	zassert_false(kfsw_ftp_path_is_read_only("/tmp/a.bin"));
	zassert_true(kfsw_ftp_path_is_read_only("/hk/a.bin"));

	zassert_ok(kfsw_ftp_mkdir(node, "/tmp/scratch"));
	zassert_ok(kfsw_ftp_stat(node, "/tmp/scratch", &info));
	zassert_equal(info.type, KFSW_FTP_ENTRY_DIRECTORY);
	zassert_ok(fs_stat(KFSW_STORAGE_TMP_MOUNT_POINT "/scratch", &(struct fs_dirent){0}));
}

ZTEST(services_ftp, test_space_check_keeps_a_margin)
{
	struct kfsw_storage_info tmp;

	zassert_ok(kfsw_storage_get_tmp_info(&tmp));
	zassert_ok(kfsw_ftp_check_space(KFSW_STORAGE_TMP_MOUNT_POINT "/a.bin", 1024U));
	/* Fits the free space, but not with the margin as well. */
	zassert_equal(kfsw_ftp_check_space(KFSW_STORAGE_TMP_MOUNT_POINT "/a.bin",
					   (uint32_t)tmp.free_bytes -
						   (CONFIG_KFSW_FTP_SPACE_MARGIN_BYTES / 2U)),
		      -ENOSPC);
	zassert_equal(kfsw_ftp_check_space(KFSW_STORAGE_TMP_MOUNT_POINT "/a.bin", 40000U), -ENOSPC);
}

ZTEST(services_ftp, test_public_argument_validation_and_lifecycle)
{
	struct kfsw_ftp_transfer_result transfer;

	zassert_true(kfsw_ftp_is_started());
	zassert_equal(kfsw_ftp_stat(2U, "file", NULL), -EINVAL);
	zassert_equal(kfsw_ftp_list(2U, "", NULL, NULL), -EINVAL);
	zassert_equal(kfsw_ftp_put(2U, "local", "remote", NULL), -EINVAL);
	zassert_equal(kfsw_ftp_get(2U, "remote", "local", NULL), -EINVAL);
	zassert_equal(kfsw_ftp_put(2U, "../params/parameters.dat", "remote", &transfer), -EINVAL);
	zassert_ok(kfsw_ftp_init());
}

#if CONFIG_KFSW_FWU
/* Matching of the reserved firmware upload path. */
ZTEST(services_ftp, test_reserved_firmware_path_matches_exactly)
{
	/* The path on the wire isn't terminated, so these cases pass a length and
	 * include bytes after the name.
	 */
	static const uint8_t reserved[] = "firmware.bin";
	static const uint8_t with_slash[] = "/firmware.bin";
	static const uint8_t with_trailing[] = "firmware.binXXXX";
	static const uint8_t nested[] = "nested/firmware.bin";
	static const uint8_t shorter[] = "firmware";

	zassert_true(kfsw_ftp_path_is_firmware(reserved, sizeof(reserved) - 1U));
	zassert_true(kfsw_ftp_path_is_firmware(with_slash, sizeof(with_slash) - 1U),
		     "a leading separator names the same file");

	/* The length decides, not a terminator. */
	zassert_true(kfsw_ftp_path_is_firmware(with_trailing, 12U),
		     "only the first path_size bytes may be considered");
	zassert_false(kfsw_ftp_path_is_firmware(with_trailing, sizeof(with_trailing) - 1U));

	zassert_false(kfsw_ftp_path_is_firmware(NULL, 12U));
	zassert_false(kfsw_ftp_path_is_firmware(reserved, 0U));
	zassert_false(kfsw_ftp_path_is_firmware(shorter, sizeof(shorter) - 1U));
	zassert_false(kfsw_ftp_path_is_firmware(nested, sizeof(nested) - 1U),
		      "the reserved name is a whole path, not a suffix");
}
#endif

ZTEST_SUITE(services_ftp, NULL, ftp_setup, NULL, NULL, NULL);
```
