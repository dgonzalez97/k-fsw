## CMakeLists.txt
```
cmake_minimum_required(VERSION 3.20.0)
get_filename_component(KFSW_WORKSPACE_ROOT "${CMAKE_CURRENT_LIST_DIR}/../../../../.." ABSOLUTE)
list(APPEND ZEPHYR_EXTRA_MODULES
    "${KFSW_WORKSPACE_ROOT}/kfsw-platform"
    "${KFSW_WORKSPACE_ROOT}/kfsw-services")
find_package(Zephyr REQUIRED HINTS $ENV{ZEPHYR_BASE})
project(kfsw_golden_hang LANGUAGES C)
target_sources(app PRIVATE src/main.c)
```

## prj.conf
```kconfig
# An image that hangs as the first thing main() does, built with the boot
# budget and the Golden installer the flight image carries, so the recovery
# path is the real one and only main() is broken. It never arms or feeds a
# watchdog: only the bootloader's can reset it.
CONFIG_BOOTLOADER_MCUBOOT=y
CONFIG_FLASH=y
CONFIG_FLASH_MAP=y
CONFIG_FLASH_PAGE_LAYOUT=y
CONFIG_STREAM_FLASH=y
CONFIG_IMG_MANAGER=y
CONFIG_MCUBOOT_IMG_MANAGER=y
CONFIG_HWINFO=y
CONFIG_REBOOT=y
CONFIG_KFSW_LASTWORDS=y
CONFIG_KFSW_BOOT_STORE=y
CONFIG_KFSW_BOOT_BUDGET=y
CONFIG_KFSW_FWU=y
CONFIG_KFSW_FWU_STANDARD=n
CONFIG_KFSW_FWU_MCUBOOT=y
CONFIG_KFSW_GOLDEN=y
CONFIG_KFSW_WATCHDOG=n
```

## boards/nucleo_l496zg.overlay
```dts
/* Layered after config/profiles/nucleo-mcuboot-flash.overlay. */
/ {
	chosen {
		zephyr,code-partition = &slot0_partition;
		kfsw,fwu-partition = &slot1_partition;
		kfsw,golden-partition = &kfsw_golden_partition;
		kfsw,boot-budget-partition = &kfsw_boot_budget_partition;
	};
};
```

## src/main.c
```c
#include <zephyr/kernel.h>

int main(void)
{
	for (;;) {
	}
	return 0;
}
```
