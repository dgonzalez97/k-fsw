/* CSP over CAN on the NUCLEO-L496ZG, on CAN1 PD0/PD1. PA11/PA12 are USB and
 * PB8/PB9 are I2C1. The board has no transceiver, so add one between PD0/PD1
 * and CAN_H/CAN_L.
 */
&can1 {
	pinctrl-0 = <&can1_rx_pd0 &can1_tx_pd1>;
	pinctrl-names = "default";
	bus-speed = <500000>;
	status = "okay";
};

/ {
	chosen {
		kfsw,csp-can = &can1;
	};
};
