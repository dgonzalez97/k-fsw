/* Binds the update service to the secondary slot from nucleo-mcuboot-flash.overlay. */
/ {
	chosen {
		kfsw,fwu-partition = &slot1_partition;
		kfsw,golden-partition = &kfsw_golden_partition;
	};
};
