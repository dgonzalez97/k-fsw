/* Ground node on a host CAN interface. native_sim bridges CAN to SocketCAN;
 * the interface defaults to zcan0 and is set at run time with --can-if.
 */
&can0 {
	status = "okay";
};

/ {
	chosen {
		kfsw,csp-can = &can0;
	};
};
