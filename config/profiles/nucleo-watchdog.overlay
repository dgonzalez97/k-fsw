/* watchdog0 names the window watchdog. Use the independent watchdog for its
 * longer timeout and operation in most low-power states.
 */
&iwdg {
	status = "okay";
};

/ {
	chosen {
		kfsw,watchdog = &iwdg;
	};
};
