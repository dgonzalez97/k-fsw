/* Application side of the MCUboot profile, on top of nucleo-mcuboot-flash.overlay.
 * The application is linked into the primary slot instead of the 960 KB
 * application partition.
 */

/delete-node/ &kfsw_app_partition;

/ {
	chosen {
		zephyr,code-partition = &slot0_partition;
	};
};
