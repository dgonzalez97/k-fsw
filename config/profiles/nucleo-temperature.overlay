/*
 * Enable ADC1 channel 17 for die temperature. The L4 SoC files omit the clock
 * source and prescaler required by the ADC binding; use the nucleo_l4r5zi values.
 */

&adc1 {
	st,adc-clock-source = "SYNC";
	st,adc-prescaler = <4>;
	status = "okay";
};

&die_temp {
	status = "okay";
};

/ {
	chosen {
		kfsw,die-temp = &die_temp;
	};
};
