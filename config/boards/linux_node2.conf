## config/boards/linux_node2.conf
```kconfig
CONFIG_KFSW_CSP_ADDRESS=2
CONFIG_KFSW_CSP_HOSTNAME="kfsw-2"
CONFIG_KFSW_CSP_UART_PEER_ADDRESS=1
```

## config/boards/linux_uart.conf
```kconfig
CONFIG_KFSW_CSP_ADDRESS=1
CONFIG_KFSW_CSP_HOSTNAME="kfsw-1"
CONFIG_KFSW_CSP_UART_PEER_ADDRESS=2
CONFIG_KFSW_CSP_UART_BAUDRATE=115200
```

## tests/unit/app_hk_entries/testcase.yaml
```yaml
---
tests:
  kfsw.app.hk_entries:
    tags:
      - unit
      - app
      - hk
    platform_allow:
      - native_sim/native
      - native_sim/native/64
    integration_platforms:
      - native_sim/native
      - native_sim/native/64
```

## tests/unit/app_param_tables/testcase.yaml
```yaml
---
tests:
  kfsw.app.param_tables:
    tags:
      - unit
      - app
      - param
      - tables
    platform_allow:
      - native_sim/native/64
    integration_platforms:
      - native_sim/native/64
```

## tests/unit/comms_can_stop/testcase.yaml
```yaml
tests:
  kfsw.comms.can_stop:
    tags:
      - unit
      - comms
      - csp
      - can
    platform_allow:
      - native_sim/native/64
    integration_platforms:
      - native_sim/native/64
```

## tests/unit/comms_can_tx/testcase.yaml
```yaml
tests:
  kfsw.comms.can_tx:
    tags:
      - unit
      - comms
      - csp
      - can
    platform_allow:
      - native_sim/native/64
    integration_platforms:
      - native_sim/native/64
```

## tests/unit/comms_csp/testcase.yaml
```yaml
---
tests:
  kfsw.comms.csp_state:
    tags:
      - unit
      - comms
      - csp
    platform_allow:
      - native_sim/native/64
    integration_platforms:
      - native_sim/native/64
  kfsw.comms.csp_state.csp1:
    tags:
      - unit
      - comms
      - csp
    platform_allow:
      - native_sim/native/64
    integration_platforms:
      - native_sim/native/64
    extra_configs:
      - CONFIG_KFSW_CSP_VERSION_1=y
```

## tests/unit/comms_csp_routes/testcase.yaml
```yaml
---
tests:
  kfsw.comms.csp_routes:
    tags:
      - unit
      - comms
      - csp
    platform_allow:
      - native_sim/native/64
    integration_platforms:
      - native_sim/native/64
  kfsw.comms.csp_routes.csp1:
    tags:
      - unit
      - comms
      - csp
    platform_allow:
      - native_sim/native/64
    integration_platforms:
      - native_sim/native/64
    extra_configs:
      - CONFIG_KFSW_CSP_VERSION_1=y
```

## tests/unit/comms_ifstats/testcase.yaml
```yaml
---
tests:
  kfsw.comms.ifstats:
    tags:
      - unit
      - comms
      - csp
    platform_allow:
      - native_sim/native/64
    integration_platforms:
      - native_sim/native/64
  kfsw.comms.ifstats.csp1:
    tags:
      - unit
      - comms
      - csp
    platform_allow:
      - native_sim/native/64
    integration_platforms:
      - native_sim/native/64
    extra_configs:
      - CONFIG_KFSW_CSP_VERSION_1=y
```

## tests/unit/comms_routes/testcase.yaml
```yaml
tests:
  kfsw.comms.routes:
    tags: [unit, comms, csp]
    platform_allow: [native_sim/native/64]
    integration_platforms: [native_sim/native/64]
```

## tests/unit/comms_routing/testcase.yaml
```yaml
---
tests:
  kfsw.comms.routing:
    tags:
      - unit
      - comms
      - csp
      - routing
    platform_allow:
      - native_sim/native/64
    integration_platforms:
      - native_sim/native/64
  kfsw.comms.routing.csp1:
    tags:
      - unit
      - comms
      - csp
      - routing
    extra_configs:
      - CONFIG_KFSW_CSP_VERSION_1=y
    platform_allow:
      - native_sim/native/64
    integration_platforms:
      - native_sim/native/64
```

## tests/unit/comms_uart_validation/testcase.yaml
```yaml
---
tests:
  kfsw.comms.uart_duplicate_name:
    tags:
      - unit
      - comms
      - csp
      - uart
      - routing
    platform_allow:
      - native_sim/native/64
    integration_platforms:
      - native_sim/native/64
```

## tests/unit/modules_gpredict/testcase.yaml
```yaml
tests:
  kfsw.modules.gpredict:
    tags: [unit, modules, gpredict]
    platform_allow: [native_sim/native/64]
    integration_platforms: [native_sim/native/64]
```

## tests/unit/modules_sensor_queue/testcase.yaml
```yaml
tests:
  kfsw.modules.sensor_queue:
    tags: [unit, modules, sensor]
    platform_allow: [native_sim/native/64]
    integration_platforms: [native_sim/native/64]
```

## tests/unit/platform_boot_store/testcase.yaml
```yaml
tests:
  kfsw.platform.boot_store:
    tags: [unit, platform, boot]
    platform_allow: [native_sim/native/64]
    integration_platforms: [native_sim/native/64]
```

## tests/unit/platform_hardware/testcase.yaml
```yaml
---
tests:
  kfsw.platform.hardware:
    tags:
      - unit
      - platform
      - hardware
    platform_allow:
      - native_sim/native/64
    integration_platforms:
      - native_sim/native/64
```

## tests/unit/platform_lastwords/testcase.yaml
```yaml
tests:
  kfsw.platform.lastwords:
    tags:
      - unit
      - platform
      - lastwords
    platform_allow:
      - native_sim/native/64
    integration_platforms:
      - native_sim/native/64
```

## tests/unit/platform_storage/testcase.yaml
```yaml
tests:
  kfsw.platform.storage:
    tags:
      - unit
      - platform
      - storage
      - littlefs
    platform_allow:
      - native_sim/native/64
    integration_platforms:
      - native_sim/native/64
```

## tests/unit/platform_time/testcase.yaml
```yaml
---
tests:
  kfsw.platform.time:
    tags:
      - unit
      - platform
      - time
    platform_allow:
      - native_sim/native/64
    integration_platforms:
      - native_sim/native/64
```

## tests/unit/radio_crypto/testcase.yaml
```yaml
tests:
  kfsw.modules.radio_crypto:
    tags: [unit, modules, radio, crypto]
    platform_allow: [native_sim/native/64]
    integration_platforms: [native_sim/native/64]
  kfsw.modules.radio_crypto.csp1:
    tags: [unit, modules, radio, crypto]
    platform_allow: [native_sim/native/64]
    integration_platforms: [native_sim/native/64]
    extra_configs:
      - CONFIG_KFSW_CSP_VERSION_1=y
```

## tests/unit/services_boot/testcase.yaml
```yaml
tests:
  kfsw.services.boot:
    tags: [unit, services, boot]
    platform_allow: [native_sim/native/64]
    integration_platforms: [native_sim/native/64]
```

## tests/unit/services_boot_budget/testcase.yaml
```yaml
tests:
  kfsw.services.boot_budget:
    tags: [unit, services, fwu, boot]
    platform_allow: [native_sim/native/64]
    integration_platforms: [native_sim/native/64]
```

## tests/unit/services_boot_diagnostics/testcase.yaml
```yaml
tests:
  kfsw.services.boot_diagnostics:
    tags: [unit, services, boot, storage]
    platform_allow: [native_sim/native/64]
    integration_platforms: [native_sim/native/64]
```

## tests/unit/services_command/testcase.yaml
```yaml
tests:
  kfsw.services.command:
    tags:
      - unit
      - services
      - command
    platform_allow:
      - native_sim/native/64
    integration_platforms:
      - native_sim/native/64
```
